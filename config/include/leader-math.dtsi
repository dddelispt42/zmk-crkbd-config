/*
 * Math symbol leader sequences: leader1 then M then the typst name.
 *
 *   leader1 + M + S U M            -> U+2211   (sym.sum)
 *   leader1 + M + A R R O W DOT R  -> U+2192   (sym.arrow.r)
 *
 * GENERATED by scripts/gen_leader_symbols.py from typst/codex sym.txt.
 * Do not edit by hand; re-run the script instead.
 *
 * Chosen by usefulness, NOT by whether they conflict: every symbol is
 * ranked by how often its section appears in ordinary maths, and a name
 * that clashes with one already taken is RENAMED rather than dropped
 * (arrow.r.bar -> arrowRBar, or the LaTeX command where one exists).
 * Only a symbol whose every spelling is taken is commented out.
 *
 * Greek is absent on purpose: leader1 + G covers all 25 letters, and
 * the same sequence with Shift gives the capitals.
 */

&leader1 {
    /* --- active (509) --- */
    seq_m_Im { sequence = <M I M DOT>; bindings = <&uc 0x2111 0>; };  // Im = ℑ
    seq_m_NN { sequence = <M N N>; bindings = <&uc 0x2115 0>; };  // NN = ℕ
    seq_m_QQ { sequence = <M Q Q>; bindings = <&uc 0x211A 0>; };  // QQ = ℚ
    seq_m_RR { sequence = <M R R>; bindings = <&uc 0x211D 0>; };  // RR = ℝ
    seq_m_Re { sequence = <M R E>; bindings = <&uc 0x211C 0>; };  // Re = ℜ
    seq_m_ZZ { sequence = <M Z Z>; bindings = <&uc 0x2124 0>; };  // ZZ = ℤ
    seq_m_amp_inv { sequence = <M A M P I N V>; bindings = <&uc 0x214B 0>; };  // amp.inv = ⅋
    seq_m_and { sequence = <M A N D DOT>; bindings = <&uc 0x2227 0>; };  // and = ∧
    seq_m_and_big { sequence = <M A N D B I G>; bindings = <&uc 0x22C0 0>; };  // and.big = ⋀
    seq_m_and_curly { sequence = <M A N D C U R L Y>; bindings = <&uc 0x22CF 0>; };  // and.curly = ⋏
    seq_m_angle { sequence = <M A N G L E DOT>; bindings = <&uc 0x2220 0>; };  // angle = ∠
    seq_m_angle_acute { sequence = <M A N G L E A C U T E>; bindings = <&uc 0x299F 0>; };  // angle.acute = ⦟
    seq_m_angle_arc { sequence = <M A N G L E A R C DOT>; bindings = <&uc 0x2221 0>; };  // angle.arc = ∡
    seq_m_angle_arc_rev { sequence = <M A N G L E A R C R E V>; bindings = <&uc 0x299B 0>; };  // angle.arc.rev = ⦛
    seq_m_angle_azimuth { sequence = <M A N G L E A Z I M U T H>; bindings = <&uc 0x237C 0>; };  // angle.azimuth = ⍼
    seq_m_angle_obtuse { sequence = <M A N G L E O B T U S E>; bindings = <&uc 0x29A6 0>; };  // angle.obtuse = ⦦
    seq_m_angle_rev { sequence = <M A N G L E R E V>; bindings = <&uc 0x29A3 0>; };  // angle.rev = ⦣
    seq_m_angle_right { sequence = <M A N G L E R I G H T>; bindings = <&uc 0x221F 0>; };  // angle.right = ∟
    seq_m_angle_s { sequence = <M A N G L E S DOT>; bindings = <&uc 0x299E 0>; };  // angle.s = ⦞
    seq_m_angle_spatial { sequence = <M A N G L E S P A T I A L>; bindings = <&uc 0x27C0 0>; };  // angle.spatial = ⟀
    seq_m_angle_spheric { sequence = <M A N G L E S P H E R I C>; bindings = <&uc 0x2222 0>; };  // angle.spheric = ∢
    seq_m_angstrom { sequence = <M A N G S T R O M>; bindings = <&uc 0xC5 0>; };  // angstrom = Å
    seq_m_angzarr { sequence = <M A N G Z A R R>; bindings = <&uc 0x237C 0>; };  // angzarr = ⍼
    seq_m_approx { sequence = <M A P P R O X DOT>; bindings = <&uc 0x2248 0>; };  // approx = ≈
    seq_m_approx_eq { sequence = <M A P P R O X E Q>; bindings = <&uc 0x224A 0>; };  // approx.eq = ≊
    seq_m_approx_not { sequence = <M A P P R O X N O T>; bindings = <&uc 0x2249 0>; };  // approx.not = ≉
    seq_m_arrow_b { sequence = <M A R R O W B DOT>; bindings = <&uc 0x2193 0>; };  // arrow.b = ↓
    seq_m_arrow_b_bar { sequence = <M A R R O W B B A R>; bindings = <&uc 0x21A7 0>; };  // arrow.b.bar = ↧
    seq_m_arrow_b_curve { sequence = <M A R R O W B C U R V E>; bindings = <&uc 0x2935 0 &uc 0xFE0E 0>; };  // arrow.b.curve = ⤵
    seq_m_arrow_b_dashed { sequence = <M A R R O W B D A S H E D>; bindings = <&uc 0x21E3 0>; };  // arrow.b.dashed = ⇣
    seq_m_arrow_b_double { sequence = <M A R R O W B D O U B L E>; bindings = <&uc 0x21D3 0>; };  // arrow.b.double = ⇓
    seq_m_arrow_b_filled { sequence = <M A R R O W B F I L L E D>; bindings = <&uc 0x2B07 0 &uc 0xFE0E 0>; };  // arrow.b.filled = ⬇
    seq_m_arrow_b_quad { sequence = <M A R R O W B Q U A D>; bindings = <&uc 0x27F1 0>; };  // arrow.b.quad = ⟱
    seq_m_arrow_b_stop { sequence = <M A R R O W B S T O P>; bindings = <&uc 0x2913 0>; };  // arrow.b.stop = ⤓
    seq_m_arrow_b_stroked { sequence = <M A R R O W B S T R O K E D>; bindings = <&uc 0x21E9 0>; };  // arrow.b.stroked = ⇩
    seq_m_arrow_b_struck { sequence = <M A R R O W B S T R U C K>; bindings = <&uc 0x2908 0>; };  // arrow.b.struck = ⤈
    seq_m_arrow_b_triple { sequence = <M A R R O W B T R I P L E>; bindings = <&uc 0x290B 0>; };  // arrow.b.triple = ⤋
    seq_m_arrow_b_turn { sequence = <M A R R O W B T U R N>; bindings = <&uc 0x2B8F 0>; };  // arrow.b.turn = ⮏
    seq_m_arrow_bl { sequence = <M A R R O W B L DOT>; bindings = <&uc 0x2199 0 &uc 0xFE0E 0>; };  // arrow.bl = ↙
    seq_m_arrow_bl_double { sequence = <M A R R O W B L D O U B L E>; bindings = <&uc 0x21D9 0>; };  // arrow.bl.double = ⇙
    seq_m_arrow_bl_filled { sequence = <M A R R O W B L F I L L E D>; bindings = <&uc 0x2B0B 0>; };  // arrow.bl.filled = ⬋
    seq_m_arrow_bl_hook { sequence = <M A R R O W B L H O O K>; bindings = <&uc 0x2926 0>; };  // arrow.bl.hook = ⤦
    seq_m_arrow_bl_stroked { sequence = <M A R R O W B L S T R O K E D>; bindings = <&uc 0x2B03 0>; };  // arrow.bl.stroked = ⬃
    seq_m_arrow_br { sequence = <M A R R O W B R DOT>; bindings = <&uc 0x2198 0 &uc 0xFE0E 0>; };  // arrow.br = ↘
    seq_m_arrow_br_double { sequence = <M A R R O W B R D O U B L E>; bindings = <&uc 0x21D8 0>; };  // arrow.br.double = ⇘
    seq_m_arrow_br_filled { sequence = <M A R R O W B R F I L L E D>; bindings = <&uc 0x2B0A 0>; };  // arrow.br.filled = ⬊
    seq_m_arrow_br_hook { sequence = <M A R R O W B R H O O K>; bindings = <&uc 0x2925 0>; };  // arrow.br.hook = ⤥
    seq_m_arrow_br_stroked { sequence = <M A R R O W B R S T R O K E D>; bindings = <&uc 0x2B02 0>; };  // arrow.br.stroked = ⬂
    seq_m_arrow_ccw { sequence = <M A R R O W C C W DOT>; bindings = <&uc 0x21BA 0>; };  // arrow.ccw = ↺
    seq_m_arrow_ccw_half { sequence = <M A R R O W C C W H A L F>; bindings = <&uc 0x21B6 0>; };  // arrow.ccw.half = ↶
    seq_m_arrow_cw { sequence = <M A R R O W C W DOT>; bindings = <&uc 0x21BB 0>; };  // arrow.cw = ↻
    seq_m_arrow_cw_half { sequence = <M A R R O W C W H A L F>; bindings = <&uc 0x21B7 0>; };  // arrow.cw.half = ↷
    seq_m_arrow_l { sequence = <M A R R O W L DOT>; bindings = <&uc 0x2190 0>; };  // arrow.l = ←
    seq_m_arrow_l_bar { sequence = <M A R R O W L B A R>; bindings = <&uc 0x21A4 0>; };  // arrow.l.bar = ↤
    seq_m_arrow_l_curve { sequence = <M A R R O W L C U R V E>; bindings = <&uc 0x2936 0>; };  // arrow.l.curve = ⤶
    seq_m_arrow_l_dashed { sequence = <M A R R O W L D A S H E D>; bindings = <&uc 0x21E0 0>; };  // arrow.l.dashed = ⇠
    seq_m_arrow_l_dotted { sequence = <M A R R O W L D O T T E D>; bindings = <&uc 0x2B38 0>; };  // arrow.l.dotted = ⬸
    seq_m_arrow_l_double { sequence = <M A R R O W L D O U B L E DOT>; bindings = <&uc 0x21D0 0>; };  // arrow.l.double = ⇐
    seq_m_arrow_l_double_long { sequence = <M A R R O W L D O U B L E L O N G DOT>; bindings = <&uc 0x27F8 0>; };  // arrow.l.double.long = ⟸
    seq_m_arrow_l_double_long_bar { sequence = <M A R R O W L D O U B L E L O N G B A R>; bindings = <&uc 0x27FD 0>; };  // arrow.l.double.long.bar = ⟽
    seq_m_arrow_l_filled { sequence = <M A R R O W L F I L L E D>; bindings = <&uc 0x2B05 0 &uc 0xFE0E 0>; };  // arrow.l.filled = ⬅
    seq_m_arrow_l_hook { sequence = <M A R R O W L H O O K>; bindings = <&uc 0x21A9 0 &uc 0xFE0E 0>; };  // arrow.l.hook = ↩
    seq_m_arrow_l_long { sequence = <M A R R O W L L O N G DOT>; bindings = <&uc 0x27F5 0>; };  // arrow.l.long = ⟵
    seq_m_arrow_l_long_squiggly { sequence = <M A R R O W L L O N G S Q U I G G L Y>; bindings = <&uc 0x2B33 0>; };  // arrow.l.long.squiggly = ⬳
    seq_m_arrow_l_loop { sequence = <M A R R O W L L O O P>; bindings = <&uc 0x21AB 0>; };  // arrow.l.loop = ↫
    seq_m_arrow_l_not { sequence = <M A R R O W L N O T>; bindings = <&uc 0x219A 0>; };  // arrow.l.not = ↚
    seq_m_arrow_l_open { sequence = <M A R R O W L O P E N>; bindings = <&uc 0x21FD 0>; };  // arrow.l.open = ⇽
    seq_m_arrow_l_quad { sequence = <M A R R O W L Q U A D>; bindings = <&uc 0x2B45 0>; };  // arrow.l.quad = ⭅
    seq_m_arrow_l_r { sequence = <M A R R O W L R DOT>; bindings = <&uc 0x2194 0 &uc 0xFE0E 0>; };  // arrow.l.r = ↔
    seq_m_arrow_l_r_double { sequence = <M A R R O W L R D O U B L E DOT>; bindings = <&uc 0x21D4 0>; };  // arrow.l.r.double = ⇔
    seq_m_arrow_l_r_double_long { sequence = <M A R R O W L R D O U B L E L O N G>; bindings = <&uc 0x27FA 0>; };  // arrow.l.r.double.long = ⟺
    seq_m_arrow_l_r_double_not { sequence = <M A R R O W L R D O U B L E N O T>; bindings = <&uc 0x21CE 0>; };  // arrow.l.r.double.not = ⇎
    seq_m_arrow_l_r_double_struck { sequence = <M A R R O W L R D O U B L E S T R U C K>; bindings = <&uc 0x2904 0>; };  // arrow.l.r.double.struck = ⤄
    seq_m_arrow_l_r_filled { sequence = <M A R R O W L R F I L L E D>; bindings = <&uc 0x2B0C 0>; };  // arrow.l.r.filled = ⬌
    seq_m_arrow_l_r_stroked { sequence = <M A R R O W L R S T R O K E D>; bindings = <&uc 0x2B04 0>; };  // arrow.l.r.stroked = ⬄
    seq_m_arrow_l_squiggly { sequence = <M A R R O W L S Q U I G G L Y>; bindings = <&uc 0x21DC 0>; };  // arrow.l.squiggly = ⇜
    seq_m_arrow_l_stop { sequence = <M A R R O W L S T O P>; bindings = <&uc 0x21E4 0>; };  // arrow.l.stop = ⇤
    seq_m_arrow_l_stroked { sequence = <M A R R O W L S T R O K E D>; bindings = <&uc 0x21E6 0>; };  // arrow.l.stroked = ⇦
    seq_m_arrow_l_struck { sequence = <M A R R O W L S T R U C K>; bindings = <&uc 0x21F7 0>; };  // arrow.l.struck = ⇷
    seq_m_arrow_l_tail { sequence = <M A R R O W L T A I L>; bindings = <&uc 0x21A2 0>; };  // arrow.l.tail = ↢
    seq_m_arrow_l_tilde { sequence = <M A R R O W L T I L D E>; bindings = <&uc 0x2B49 0>; };  // arrow.l.tilde = ⭉
    seq_m_arrow_l_triple { sequence = <M A R R O W L T R I P L E>; bindings = <&uc 0x21DA 0>; };  // arrow.l.triple = ⇚
    seq_m_arrow_l_turn { sequence = <M A R R O W L T U R N>; bindings = <&uc 0x2B8C 0>; };  // arrow.l.turn = ⮌
    seq_m_arrow_l_wave { sequence = <M A R R O W L W A V E>; bindings = <&uc 0x219C 0>; };  // arrow.l.wave = ↜
    seq_m_arrow_r { sequence = <M A R R O W R DOT>; bindings = <&uc 0x2192 0>; };  // arrow.r = →
    seq_m_arrow_r_bar { sequence = <M A R R O W R B A R>; bindings = <&uc 0x21A6 0>; };  // arrow.r.bar = ↦
    seq_m_arrow_r_curve { sequence = <M A R R O W R C U R V E>; bindings = <&uc 0x2937 0>; };  // arrow.r.curve = ⤷
    seq_m_arrow_r_dashed { sequence = <M A R R O W R D A S H E D>; bindings = <&uc 0x21E2 0>; };  // arrow.r.dashed = ⇢
    seq_m_arrow_r_dotted { sequence = <M A R R O W R D O T T E D>; bindings = <&uc 0x2911 0>; };  // arrow.r.dotted = ⤑
    seq_m_arrow_r_double { sequence = <M A R R O W R D O U B L E DOT>; bindings = <&uc 0x21D2 0>; };  // arrow.r.double = ⇒
    seq_m_arrow_r_double_long { sequence = <M A R R O W R D O U B L E L O N G DOT>; bindings = <&uc 0x27F9 0>; };  // arrow.r.double.long = ⟹
    seq_m_arrow_r_double_long_bar { sequence = <M A R R O W R D O U B L E L O N G B A R>; bindings = <&uc 0x27FE 0>; };  // arrow.r.double.long.bar = ⟾
    seq_m_arrow_r_filled { sequence = <M A R R O W R F I L L E D>; bindings = <&uc 0x27A1 0 &uc 0xFE0E 0>; };  // arrow.r.filled = ➡
    seq_m_arrow_r_hook { sequence = <M A R R O W R H O O K>; bindings = <&uc 0x21AA 0 &uc 0xFE0E 0>; };  // arrow.r.hook = ↪
    seq_m_arrow_r_long { sequence = <M A R R O W R L O N G DOT>; bindings = <&uc 0x27F6 0>; };  // arrow.r.long = ⟶
    seq_m_arrow_r_long_squiggly { sequence = <M A R R O W R L O N G S Q U I G G L Y>; bindings = <&uc 0x27FF 0>; };  // arrow.r.long.squiggly = ⟿
    seq_m_arrow_r_loop { sequence = <M A R R O W R L O O P>; bindings = <&uc 0x21AC 0>; };  // arrow.r.loop = ↬
    seq_m_arrow_r_not { sequence = <M A R R O W R N O T>; bindings = <&uc 0x219B 0>; };  // arrow.r.not = ↛
    seq_m_arrow_r_open { sequence = <M A R R O W R O P E N>; bindings = <&uc 0x21FE 0>; };  // arrow.r.open = ⇾
    seq_m_arrow_r_quad { sequence = <M A R R O W R Q U A D>; bindings = <&uc 0x2B46 0>; };  // arrow.r.quad = ⭆
    seq_m_arrow_r_squiggly { sequence = <M A R R O W R S Q U I G G L Y>; bindings = <&uc 0x21DD 0>; };  // arrow.r.squiggly = ⇝
    seq_m_arrow_r_stop { sequence = <M A R R O W R S T O P>; bindings = <&uc 0x21E5 0>; };  // arrow.r.stop = ⇥
    seq_m_arrow_r_stroked { sequence = <M A R R O W R S T R O K E D>; bindings = <&uc 0x21E8 0>; };  // arrow.r.stroked = ⇨
    seq_m_arrow_r_struck { sequence = <M A R R O W R S T R U C K>; bindings = <&uc 0x21F8 0>; };  // arrow.r.struck = ⇸
    seq_m_arrow_r_tail { sequence = <M A R R O W R T A I L>; bindings = <&uc 0x21A3 0>; };  // arrow.r.tail = ↣
    seq_m_arrow_r_tilde { sequence = <M A R R O W R T I L D E>; bindings = <&uc 0x2972 0>; };  // arrow.r.tilde = ⥲
    seq_m_arrow_r_triple { sequence = <M A R R O W R T R I P L E>; bindings = <&uc 0x21DB 0>; };  // arrow.r.triple = ⇛
    seq_m_arrow_r_turn { sequence = <M A R R O W R T U R N>; bindings = <&uc 0x2B8E 0>; };  // arrow.r.turn = ⮎
    seq_m_arrow_r_wave { sequence = <M A R R O W R W A V E>; bindings = <&uc 0x219D 0>; };  // arrow.r.wave = ↝
    seq_m_arrow_t { sequence = <M A R R O W T DOT>; bindings = <&uc 0x2191 0>; };  // arrow.t = ↑
    seq_m_arrow_t_b { sequence = <M A R R O W T B DOT>; bindings = <&uc 0x2195 0 &uc 0xFE0E 0>; };  // arrow.t.b = ↕
    seq_m_arrow_t_b_double { sequence = <M A R R O W T B D O U B L E>; bindings = <&uc 0x21D5 0>; };  // arrow.t.b.double = ⇕
    seq_m_arrow_t_b_filled { sequence = <M A R R O W T B F I L L E D>; bindings = <&uc 0x2B0D 0>; };  // arrow.t.b.filled = ⬍
    seq_m_arrow_t_b_stroked { sequence = <M A R R O W T B S T R O K E D>; bindings = <&uc 0x21F3 0>; };  // arrow.t.b.stroked = ⇳
    seq_m_arrow_t_bar { sequence = <M A R R O W T B A R>; bindings = <&uc 0x21A5 0>; };  // arrow.t.bar = ↥
    seq_m_arrow_t_curve { sequence = <M A R R O W T C U R V E>; bindings = <&uc 0x2934 0 &uc 0xFE0E 0>; };  // arrow.t.curve = ⤴
    seq_m_arrow_t_dashed { sequence = <M A R R O W T D A S H E D>; bindings = <&uc 0x21E1 0>; };  // arrow.t.dashed = ⇡
    seq_m_arrow_t_double { sequence = <M A R R O W T D O U B L E>; bindings = <&uc 0x21D1 0>; };  // arrow.t.double = ⇑
    seq_m_arrow_t_filled { sequence = <M A R R O W T F I L L E D>; bindings = <&uc 0x2B06 0 &uc 0xFE0E 0>; };  // arrow.t.filled = ⬆
    seq_m_arrow_t_quad { sequence = <M A R R O W T Q U A D>; bindings = <&uc 0x27F0 0>; };  // arrow.t.quad = ⟰
    seq_m_arrow_t_stop { sequence = <M A R R O W T S T O P>; bindings = <&uc 0x2912 0>; };  // arrow.t.stop = ⤒
    seq_m_arrow_t_stroked { sequence = <M A R R O W T S T R O K E D>; bindings = <&uc 0x21E7 0>; };  // arrow.t.stroked = ⇧
    seq_m_arrow_t_turn { sequence = <M A R R O W T T U R N>; bindings = <&uc 0x2B8D 0>; };  // arrow.t.turn = ⮍
    seq_m_arrow_tl { sequence = <M A R R O W T L DOT>; bindings = <&uc 0x2196 0 &uc 0xFE0E 0>; };  // arrow.tl = ↖
    seq_m_arrow_tl_br { sequence = <M A R R O W T L B R>; bindings = <&uc 0x2921 0>; };  // arrow.tl.br = ⤡
    seq_m_arrow_tl_double { sequence = <M A R R O W T L D O U B L E>; bindings = <&uc 0x21D6 0>; };  // arrow.tl.double = ⇖
    seq_m_arrow_tl_filled { sequence = <M A R R O W T L F I L L E D>; bindings = <&uc 0x2B09 0>; };  // arrow.tl.filled = ⬉
    seq_m_arrow_tl_hook { sequence = <M A R R O W T L H O O K>; bindings = <&uc 0x2923 0>; };  // arrow.tl.hook = ⤣
    seq_m_arrow_tl_stroked { sequence = <M A R R O W T L S T R O K E D>; bindings = <&uc 0x2B01 0>; };  // arrow.tl.stroked = ⬁
    seq_m_arrow_tr { sequence = <M A R R O W T R DOT>; bindings = <&uc 0x2197 0 &uc 0xFE0E 0>; };  // arrow.tr = ↗
    seq_m_arrow_tr_bl { sequence = <M A R R O W T R B L>; bindings = <&uc 0x2922 0>; };  // arrow.tr.bl = ⤢
    seq_m_arrow_tr_double { sequence = <M A R R O W T R D O U B L E>; bindings = <&uc 0x21D7 0>; };  // arrow.tr.double = ⇗
    seq_m_arrow_tr_filled { sequence = <M A R R O W T R F I L L E D>; bindings = <&uc 0x2B08 0>; };  // arrow.tr.filled = ⬈
    seq_m_arrow_tr_hook { sequence = <M A R R O W T R H O O K>; bindings = <&uc 0x2924 0>; };  // arrow.tr.hook = ⤤
    seq_m_arrow_tr_stroked { sequence = <M A R R O W T R S T R O K E D>; bindings = <&uc 0x2B00 0>; };  // arrow.tr.stroked = ⬀
    seq_m_arrow_zigzag { sequence = <M A R R O W Z I G Z A G>; bindings = <&uc 0x21AF 0>; };  // arrow.zigzag = ↯
    seq_m_arrowhead_b { sequence = <M A R R O W H E A D B>; bindings = <&uc 0x2304 0>; };  // arrowhead.b = ⌄
    seq_m_arrowhead_t { sequence = <M A R R O W H E A D T>; bindings = <&uc 0x2303 0>; };  // arrowhead.t = ⌃
    seq_m_arrows_bb { sequence = <M A R R O W S B B>; bindings = <&uc 0x21CA 0>; };  // arrows.bb = ⇊
    seq_m_arrows_bt { sequence = <M A R R O W S B T>; bindings = <&uc 0x21F5 0>; };  // arrows.bt = ⇵
    seq_m_arrows_ll { sequence = <M A R R O W S L L DOT>; bindings = <&uc 0x21C7 0>; };  // arrows.ll = ⇇
    seq_m_arrows_lll { sequence = <M A R R O W S L L L>; bindings = <&uc 0x2B31 0>; };  // arrows.lll = ⬱
    seq_m_arrows_lr { sequence = <M A R R O W S L R DOT>; bindings = <&uc 0x21C6 0>; };  // arrows.lr = ⇆
    seq_m_arrows_lr_stop { sequence = <M A R R O W S L R S T O P>; bindings = <&uc 0x21B9 0>; };  // arrows.lr.stop = ↹
    seq_m_arrows_rl { sequence = <M A R R O W S R L>; bindings = <&uc 0x21C4 0>; };  // arrows.rl = ⇄
    seq_m_arrows_rr { sequence = <M A R R O W S R R DOT>; bindings = <&uc 0x21C9 0>; };  // arrows.rr = ⇉
    seq_m_arrows_rrr { sequence = <M A R R O W S R R R>; bindings = <&uc 0x21F6 0>; };  // arrows.rrr = ⇶
    seq_m_arrows_tb { sequence = <M A R R O W S T B>; bindings = <&uc 0x21C5 0>; };  // arrows.tb = ⇅
    seq_m_arrows_tt { sequence = <M A R R O W S T T>; bindings = <&uc 0x21C8 0>; };  // arrows.tt = ⇈
    seq_m_asymp { sequence = <M A S Y M P DOT>; bindings = <&uc 0x224D 0>; };  // asymp = ≍
    seq_m_asymp_not { sequence = <M A S Y M P N O T>; bindings = <&uc 0x226D 0>; };  // asymp.not = ≭
    seq_m_because { sequence = <M B E C A U S E>; bindings = <&uc 0x2235 0>; };  // because = ∵
    seq_m_bot { sequence = <M B O T>; bindings = <&uc 0x22A5 0>; };  // bot = ⊥
    seq_m_brace_b { sequence = <M B R A C E B>; bindings = <&uc 0x23DF 0>; };  // brace.b = ⏟
    seq_m_brace_l_stroked { sequence = <M B R A C E L S T R O K E D>; bindings = <&uc 0x2983 0>; };  // brace.l.stroked = ⦃
    seq_m_brace_r_stroked { sequence = <M B R A C E R S T R O K E D>; bindings = <&uc 0x2984 0>; };  // brace.r.stroked = ⦄
    seq_m_brace_t { sequence = <M B R A C E T>; bindings = <&uc 0x23DE 0>; };  // brace.t = ⏞
    seq_m_bracket_l_stroked { sequence = <M B R A C K E T L S T R O K E D>; bindings = <&uc 0x27E6 0>; };  // bracket.l.stroked = ⟦
    seq_m_bracket_r_stroked { sequence = <M B R A C K E T R S T R O K E D>; bindings = <&uc 0x27E7 0>; };  // bracket.r.stroked = ⟧
    seq_m_cc_by { sequence = <M C C B Y>; bindings = <&uc 0x1F16F 0>; };  // cc.by = 🅯
    seq_m_cc_nc { sequence = <M C C N C>; bindings = <&uc 0x1F10F 0>; };  // cc.nc = 🄏
    seq_m_cc_nd { sequence = <M C C N D>; bindings = <&uc 0x229C 0>; };  // cc.nd = ⊜
    seq_m_cc_public { sequence = <M C C P U B L I C>; bindings = <&uc 0x1F16E 0>; };  // cc.public = 🅮
    seq_m_cc_sa { sequence = <M C C S A>; bindings = <&uc 0x1F10E 0>; };  // cc.sa = 🄎
    seq_m_cc_zero { sequence = <M C C Z E R O>; bindings = <&uc 0x1F10D 0>; };  // cc.zero = 🄍
    seq_m_checkmark { sequence = <M C H E C K M A R K DOT>; bindings = <&uc 0x2713 0>; };  // checkmark = ✓
    seq_m_checkmark_heavy { sequence = <M C H E C K M A R K H E A V Y>; bindings = <&uc 0x2714 0 &uc 0xFE0E 0>; };  // checkmark.heavy = ✔
    seq_m_checkmark_light { sequence = <M C H E C K M A R K L I G H T>; bindings = <&uc 0x1F5F8 0>; };  // checkmark.light = 🗸
    seq_m_chess { sequence = <M C H E S S>; bindings = <&uc 0x7B 0>; };  // chess = {
    seq_m_chevron_l_curly { sequence = <M C H E V R O N L C U R L Y>; bindings = <&uc 0x29FC 0>; };  // chevron.l.curly = ⧼
    seq_m_chevron_r_curly { sequence = <M C H E V R O N R C U R L Y>; bindings = <&uc 0x29FD 0>; };  // chevron.r.curly = ⧽
    seq_m_co { sequence = <M C O DOT>; bindings = <&uc 0x2105 0>; };  // co = ℅
    seq_m_colon_eq { sequence = <M C O L O N E Q>; bindings = <&uc 0x2254 0>; };  // colon.eq = ≔
    seq_m_complement { sequence = <M C O M P L E M E N T>; bindings = <&uc 0x2201 0>; };  // complement = ∁
    seq_m_compose { sequence = <M C O M P O S E>; bindings = <&uc 0x2218 0>; };  // compose = ∘
    seq_m_convolve { sequence = <M C O N V O L V E DOT>; bindings = <&uc 0x2217 0>; };  // convolve = ∗
    seq_m_convolve_o { sequence = <M C O N V O L V E O>; bindings = <&uc 0x229B 0>; };  // convolve.o = ⊛
    seq_m_copyleft { sequence = <M C O P Y L E F T>; bindings = <&uc 0x1F12F 0>; };  // copyleft = 🄯
    seq_m_copyright { sequence = <M C O P Y R I G H T DOT>; bindings = <&uc 0xA9 0 &uc 0xFE0E 0>; };  // copyright = ©
    seq_m_copyright_sound { sequence = <M C O P Y R I G H T S O U N D>; bindings = <&uc 0x2117 0>; };  // copyright.sound = ℗
    seq_m_crossmark { sequence = <M C R O S S M A R K DOT>; bindings = <&uc 0x2717 0>; };  // crossmark = ✗
    seq_m_crossmark_heavy { sequence = <M C R O S S M A R K H E A V Y>; bindings = <&uc 0x2718 0>; };  // crossmark.heavy = ✘
    seq_m_dagger { sequence = <M D A G G E R>; bindings = <&uc 0x2020 0>; };  // dagger = †
    seq_m_dash_wave_double { sequence = <M D A S H W A V E D O U B L E>; bindings = <&uc 0x3030 0 &uc 0xFE0E 0>; };  // dash.wave.double = 〰
    seq_m_degree { sequence = <M D E G R E E>; bindings = <&uc 0xB0 0>; };  // degree = °
    seq_m_diamond_filled_medium { sequence = <M D I A M O N D F I L L E D M E D I U M>; bindings = <&uc 0x2B25 0>; };  // diamond.filled.medium = ⬥
    seq_m_div { sequence = <M D I V DOT>; bindings = <&uc 0xF7 0>; };  // div = ÷
    seq_m_div_o { sequence = <M D I V O>; bindings = <&uc 0x2A38 0>; };  // div.o = ⨸
    seq_m_div_slanted_o { sequence = <M D I V S L A N T E D O>; bindings = <&uc 0x29BC 0>; };  // div.slanted.o = ⦼
    seq_m_dot_o_big { sequence = <M D O T O B I G>; bindings = <&uc 0x2A00 0>; };  // dot.o.big = ⨀
    seq_m_ell { sequence = <M E L L>; bindings = <&uc 0x2113 0>; };  // ell = ℓ
    seq_m_emptyset { sequence = <M E M P T Y S E T DOT>; bindings = <&uc 0x2205 0>; };  // emptyset = ∅
    seq_m_emptyset_bar { sequence = <M E M P T Y S E T B A R>; bindings = <&uc 0x29B1 0>; };  // emptyset.bar = ⦱
    seq_m_emptyset_rev { sequence = <M E M P T Y S E T R E V>; bindings = <&uc 0x29B0 0>; };  // emptyset.rev = ⦰
    seq_m_eq_ast { sequence = <M E Q A S T>; bindings = <&uc 0x2A6E 0>; };  // eq.ast = ⩮
    seq_m_eq_colon { sequence = <M E Q C O L O N>; bindings = <&uc 0x2255 0>; };  // eq.colon = ≕
    seq_m_eq_def { sequence = <M E Q D E F>; bindings = <&uc 0x225D 0>; };  // eq.def = ≝
    seq_m_eq_dots_down { sequence = <M E Q D O T S D O W N>; bindings = <&uc 0x2252 0>; };  // eq.dots.down = ≒
    seq_m_eq_dots_up { sequence = <M E Q D O T S U P>; bindings = <&uc 0x2253 0>; };  // eq.dots.up = ≓
    seq_m_eq_equi { sequence = <M E Q E Q U I>; bindings = <&uc 0x225A 0>; };  // eq.equi = ≚
    seq_m_eq_est { sequence = <M E Q E S T>; bindings = <&uc 0x2259 0>; };  // eq.est = ≙
    seq_m_eq_gt { sequence = <M E Q G T DOT>; bindings = <&uc 0x22DD 0>; };  // eq.gt = ⋝
    seq_m_eq_gt_slant { sequence = <M E Q G T S L A N T>; bindings = <&uc 0x2A96 0>; };  // eq.gt.slant = ⪖
    seq_m_eq_lt { sequence = <M E Q L T DOT>; bindings = <&uc 0x22DC 0>; };  // eq.lt = ⋜
    seq_m_eq_lt_slant { sequence = <M E Q L T S L A N T>; bindings = <&uc 0x2A95 0>; };  // eq.lt.slant = ⪕
    seq_m_eq_not { sequence = <M E Q N O T>; bindings = <&uc 0x2260 0>; };  // eq.not = ≠
    seq_m_eq_prec { sequence = <M E Q P R E C>; bindings = <&uc 0x22DE 0>; };  // eq.prec = ⋞
    seq_m_eq_quad { sequence = <M E Q Q U A D>; bindings = <&uc 0x2263 0>; };  // eq.quad = ≣
    seq_m_eq_quest { sequence = <M E Q Q U E S T>; bindings = <&uc 0x225F 0>; };  // eq.quest = ≟
    seq_m_eq_succ { sequence = <M E Q S U C C>; bindings = <&uc 0x22DF 0>; };  // eq.succ = ⋟
    seq_m_eq_triple { sequence = <M E Q T R I P L E DOT>; bindings = <&uc 0x2261 0>; };  // eq.triple = ≡
    seq_m_eq_triple_not { sequence = <M E Q T R I P L E N O T>; bindings = <&uc 0x2262 0>; };  // eq.triple.not = ≢
    seq_m_equiv { sequence = <M E Q U I V DOT>; bindings = <&uc 0x2261 0>; };  // equiv = ≡
    seq_m_equiv_gt { sequence = <M E Q U I V G T DOT>; bindings = <&uc 0x2A9A 0>; };  // equiv.gt = ⪚
    seq_m_equiv_gt_slant { sequence = <M E Q U I V G T S L A N T>; bindings = <&uc 0x2A9C 0>; };  // equiv.gt.slant = ⪜
    seq_m_equiv_lt { sequence = <M E Q U I V L T DOT>; bindings = <&uc 0x2A99 0>; };  // equiv.lt = ⪙
    seq_m_equiv_lt_slant { sequence = <M E Q U I V L T S L A N T>; bindings = <&uc 0x2A9B 0>; };  // equiv.lt.slant = ⪛
    seq_m_equiv_not { sequence = <M E Q U I V N O T>; bindings = <&uc 0x2262 0>; };  // equiv.not = ≢
    seq_m_excl_double { sequence = <M E X C L D O U B L E>; bindings = <&uc 0x203C 0 &uc 0xFE0E 0>; };  // excl.double = ‼
    seq_m_excl_quest { sequence = <M E X C L Q U E S T>; bindings = <&uc 0x2049 0 &uc 0xFE0E 0>; };  // excl.quest = ⁉
    seq_m_exists { sequence = <M E X I S T S DOT>; bindings = <&uc 0x2203 0>; };  // exists = ∃
    seq_m_exists_not { sequence = <M E X I S T S N O T>; bindings = <&uc 0x2204 0>; };  // exists.not = ∄
    seq_m_female { sequence = <M F E M A L E DOT>; bindings = <&uc 0x2640 0 &uc 0xFE0E 0>; };  // female = ♀
    seq_m_female_double { sequence = <M F E M A L E D O U B L E>; bindings = <&uc 0x26A2 0>; };  // female.double = ⚢
    seq_m_female_male { sequence = <M F E M A L E M A L E>; bindings = <&uc 0x26A4 0>; };  // female.male = ⚤
    seq_m_fence_l { sequence = <M F E N C E L DOT>; bindings = <&uc 0x29D8 0>; };  // fence.l = ⧘
    seq_m_fence_l_double { sequence = <M F E N C E L D O U B L E>; bindings = <&uc 0x29DA 0>; };  // fence.l.double = ⧚
    seq_m_fence_r { sequence = <M F E N C E R DOT>; bindings = <&uc 0x29D9 0>; };  // fence.r = ⧙
    seq_m_fence_r_double { sequence = <M F E N C E R D O U B L E>; bindings = <&uc 0x29DB 0>; };  // fence.r.double = ⧛
    seq_m_forall { sequence = <M F O R A L L>; bindings = <&uc 0x2200 0>; };  // forall = ∀
    seq_m_forces { sequence = <M F O R C E S DOT>; bindings = <&uc 0x22A9 0>; };  // forces = ⊩
    seq_m_forces_not { sequence = <M F O R C E S N O T>; bindings = <&uc 0x22AE 0>; };  // forces.not = ⊮
    seq_m_gradient { sequence = <M G R A D I E N T>; bindings = <&uc 0x2207 0>; };  // gradient = ∇
    seq_m_gt_approx { sequence = <M G T A P P R O X>; bindings = <&uc 0x2A86 0>; };  // gt.approx = ⪆
    seq_m_gt_arc { sequence = <M G T A R C DOT>; bindings = <&uc 0x2AA7 0>; };  // gt.arc = ⪧
    seq_m_gt_arc_eq { sequence = <M G T A R C E Q>; bindings = <&uc 0x2AA9 0>; };  // gt.arc.eq = ⪩
    seq_m_gt_closed { sequence = <M G T C L O S E D DOT>; bindings = <&uc 0x22B3 0>; };  // gt.closed = ⊳
    seq_m_gt_closed_eq { sequence = <M G T C L O S E D E Q>; bindings = <&uc 0x22B5 0>; };  // gt.closed.eq = ⊵
    seq_m_gt_eq { sequence = <M G T E Q DOT>; bindings = <&uc 0x2265 0>; };  // gt.eq = ≥
    seq_m_gt_eq_lt { sequence = <M G T E Q L T>; bindings = <&uc 0x22DB 0>; };  // gt.eq.lt = ⋛
    seq_m_gt_eq_not { sequence = <M G T E Q N O T>; bindings = <&uc 0x2271 0>; };  // gt.eq.not = ≱
    seq_m_gt_eq_slant { sequence = <M G T E Q S L A N T>; bindings = <&uc 0x2A7E 0>; };  // gt.eq.slant = ⩾
    seq_m_gt_equiv { sequence = <M G T E Q U I V DOT>; bindings = <&uc 0x2267 0>; };  // gt.equiv = ≧
    seq_m_gt_equiv_slant { sequence = <M G T E Q U I V S L A N T>; bindings = <&uc 0x2AFA 0>; };  // gt.equiv.slant = ⫺
    seq_m_gt_lt { sequence = <M G T L T DOT>; bindings = <&uc 0x2277 0>; };  // gt.lt = ≷
    seq_m_gt_lt_not { sequence = <M G T L T N O T>; bindings = <&uc 0x2279 0>; };  // gt.lt.not = ≹
    seq_m_gt_napprox { sequence = <M G T N A P P R O X>; bindings = <&uc 0x2A8A 0>; };  // gt.napprox = ⪊
    seq_m_gt_neq { sequence = <M G T N E Q DOT>; bindings = <&uc 0x2A88 0>; };  // gt.neq = ⪈
    seq_m_gt_nequiv { sequence = <M G T N E Q U I V>; bindings = <&uc 0x2269 0>; };  // gt.nequiv = ≩
    seq_m_gt_not { sequence = <M G T N O T>; bindings = <&uc 0x226F 0>; };  // gt.not = ≯
    seq_m_gt_ntilde { sequence = <M G T N T I L D E>; bindings = <&uc 0x22E7 0>; };  // gt.ntilde = ⋧
    seq_m_gt_o { sequence = <M G T O>; bindings = <&uc 0x29C1 0>; };  // gt.o = ⧁
    seq_m_gt_quest { sequence = <M G T Q U E S T>; bindings = <&uc 0x2A7C 0>; };  // gt.quest = ⩼
    seq_m_gt_tilde { sequence = <M G T T I L D E DOT>; bindings = <&uc 0x2273 0>; };  // gt.tilde = ≳
    seq_m_gt_tilde_not { sequence = <M G T T I L D E N O T>; bindings = <&uc 0x2275 0>; };  // gt.tilde.not = ≵
    seq_m_gt_triple { sequence = <M G T T R I P L E>; bindings = <&uc 0x22D9 0>; };  // gt.triple = ⋙
    seq_m_harpoon_bl { sequence = <M H A R P O O N B L>; bindings = <&uc 0x21C3 0>; };  // harpoon.bl = ⇃
    seq_m_harpoon_br { sequence = <M H A R P O O N B R>; bindings = <&uc 0x21C2 0>; };  // harpoon.br = ⇂
    seq_m_harpoon_lb { sequence = <M H A R P O O N L B DOT>; bindings = <&uc 0x21BD 0>; };  // harpoon.lb = ↽
    seq_m_harpoon_lb_rb { sequence = <M H A R P O O N L B R B>; bindings = <&uc 0x2950 0>; };  // harpoon.lb.rb = ⥐
    seq_m_harpoon_lb_rt { sequence = <M H A R P O O N L B R T>; bindings = <&uc 0x294B 0>; };  // harpoon.lb.rt = ⥋
    seq_m_harpoon_lt { sequence = <M H A R P O O N L T DOT>; bindings = <&uc 0x21BC 0>; };  // harpoon.lt = ↼
    seq_m_harpoon_lt_rb { sequence = <M H A R P O O N L T R B>; bindings = <&uc 0x294A 0>; };  // harpoon.lt.rb = ⥊
    seq_m_harpoon_lt_rt { sequence = <M H A R P O O N L T R T>; bindings = <&uc 0x294E 0>; };  // harpoon.lt.rt = ⥎
    seq_m_harpoon_rb { sequence = <M H A R P O O N R B>; bindings = <&uc 0x21C1 0>; };  // harpoon.rb = ⇁
    seq_m_harpoon_rt { sequence = <M H A R P O O N R T>; bindings = <&uc 0x21C0 0>; };  // harpoon.rt = ⇀
    seq_m_harpoon_tl { sequence = <M H A R P O O N T L DOT>; bindings = <&uc 0x21BF 0>; };  // harpoon.tl = ↿
    seq_m_harpoon_tl_bl { sequence = <M H A R P O O N T L B L>; bindings = <&uc 0x2951 0>; };  // harpoon.tl.bl = ⥑
    seq_m_harpoon_tl_br { sequence = <M H A R P O O N T L B R>; bindings = <&uc 0x294D 0>; };  // harpoon.tl.br = ⥍
    seq_m_harpoon_tr { sequence = <M H A R P O O N T R DOT>; bindings = <&uc 0x21BE 0>; };  // harpoon.tr = ↾
    seq_m_harpoon_tr_bl { sequence = <M H A R P O O N T R B L>; bindings = <&uc 0x294C 0>; };  // harpoon.tr.bl = ⥌
    seq_m_harpoon_tr_br { sequence = <M H A R P O O N T R B R>; bindings = <&uc 0x294F 0>; };  // harpoon.tr.br = ⥏
    seq_m_harpoons_blbr { sequence = <M H A R P O O N S B L B R>; bindings = <&uc 0x2965 0>; };  // harpoons.blbr = ⥥
    seq_m_harpoons_bltr { sequence = <M H A R P O O N S B L T R>; bindings = <&uc 0x296F 0>; };  // harpoons.bltr = ⥯
    seq_m_harpoons_lbrb { sequence = <M H A R P O O N S L B R B>; bindings = <&uc 0x2967 0>; };  // harpoons.lbrb = ⥧
    seq_m_harpoons_ltlb { sequence = <M H A R P O O N S L T L B>; bindings = <&uc 0x2962 0>; };  // harpoons.ltlb = ⥢
    seq_m_harpoons_ltrb { sequence = <M H A R P O O N S L T R B>; bindings = <&uc 0x21CB 0>; };  // harpoons.ltrb = ⇋
    seq_m_harpoons_ltrt { sequence = <M H A R P O O N S L T R T>; bindings = <&uc 0x2966 0>; };  // harpoons.ltrt = ⥦
    seq_m_harpoons_rblb { sequence = <M H A R P O O N S R B L B>; bindings = <&uc 0x2969 0>; };  // harpoons.rblb = ⥩
    seq_m_harpoons_rtlb { sequence = <M H A R P O O N S R T L B>; bindings = <&uc 0x21CC 0>; };  // harpoons.rtlb = ⇌
    seq_m_harpoons_rtlt { sequence = <M H A R P O O N S R T L T>; bindings = <&uc 0x2968 0>; };  // harpoons.rtlt = ⥨
    seq_m_harpoons_rtrb { sequence = <M H A R P O O N S R T R B>; bindings = <&uc 0x2964 0>; };  // harpoons.rtrb = ⥤
    seq_m_harpoons_tlbr { sequence = <M H A R P O O N S T L B R>; bindings = <&uc 0x296E 0>; };  // harpoons.tlbr = ⥮
    seq_m_harpoons_tltr { sequence = <M H A R P O O N S T L T R>; bindings = <&uc 0x2963 0>; };  // harpoons.tltr = ⥣
    seq_m_hourglass_filled { sequence = <M H O U R G L A S S F I L L E D>; bindings = <&uc 0x29D7 0>; };  // hourglass.filled = ⧗
    seq_m_hourglass_stroked { sequence = <M H O U R G L A S S S T R O K E D>; bindings = <&uc 0x29D6 0>; };  // hourglass.stroked = ⧖
    seq_m_image { sequence = <M I M A G E>; bindings = <&uc 0x22B7 0>; };  // image = ⊷
    seq_m_in { sequence = <M I N DOT>; bindings = <&uc 0x2208 0>; };  // in = ∈
    seq_m_in_not { sequence = <M I N N O T>; bindings = <&uc 0x2209 0>; };  // in.not = ∉
    seq_m_in_rev { sequence = <M I N R E V DOT>; bindings = <&uc 0x220B 0>; };  // in.rev = ∋
    seq_m_in_rev_not { sequence = <M I N R E V N O T>; bindings = <&uc 0x220C 0>; };  // in.rev.not = ∌
    seq_m_in_rev_small { sequence = <M I N R E V S M A L L>; bindings = <&uc 0x220D 0>; };  // in.rev.small = ∍
    seq_m_in_small { sequence = <M I N S M A L L>; bindings = <&uc 0x220A 0>; };  // in.small = ∊
    seq_m_infinity { sequence = <M I N F I N I T Y DOT>; bindings = <&uc 0x221E 0>; };  // infinity = ∞
    seq_m_infinity_bar { sequence = <M I N F I N I T Y B A R>; bindings = <&uc 0x29DE 0>; };  // infinity.bar = ⧞
    seq_m_infinity_incomplete { sequence = <M I N F I N I T Y I N C O M P L E T E>; bindings = <&uc 0x29DC 0>; };  // infinity.incomplete = ⧜
    seq_m_infinity_tie { sequence = <M I N F I N I T Y T I E>; bindings = <&uc 0x29DD 0>; };  // infinity.tie = ⧝
    seq_m_integral { sequence = <M I N T E G R A L DOT>; bindings = <&uc 0x222B 0>; };  // integral = ∫
    seq_m_integral_cont { sequence = <M I N T E G R A L C O N T>; bindings = <&uc 0x222E 0>; };  // integral.cont = ∮
    seq_m_integral_dash { sequence = <M I N T E G R A L D A S H>; bindings = <&uc 0x2A0D 0>; };  // integral.dash = ⨍
    seq_m_integral_double { sequence = <M I N T E G R A L D O U B L E>; bindings = <&uc 0x222C 0>; };  // integral.double = ∬
    seq_m_integral_triple { sequence = <M I N T E G R A L T R I P L E>; bindings = <&uc 0x222D 0>; };  // integral.triple = ∭
    seq_m_inter { sequence = <M I N T E R DOT>; bindings = <&uc 0x2229 0>; };  // inter = ∩
    seq_m_inter_big { sequence = <M I N T E R B I G>; bindings = <&uc 0x22C2 0>; };  // inter.big = ⋂
    seq_m_inter_sq { sequence = <M I N T E R S Q DOT>; bindings = <&uc 0x2293 0>; };  // inter.sq = ⊓
    seq_m_inter_sq_big { sequence = <M I N T E R S Q B I G>; bindings = <&uc 0x2A05 0>; };  // inter.sq.big = ⨅
    seq_m_interrobang { sequence = <M I N T E R R O B A N G DOT>; bindings = <&uc 0x203D 0>; };  // interrobang = ‽
    seq_m_interrobang_inv { sequence = <M I N T E R R O B A N G I N V>; bindings = <&uc 0x2E18 0>; };  // interrobang.inv = ⸘
    seq_m_intersex { sequence = <M I N T E R S E X>; bindings = <&uc 0x26A5 0>; };  // intersex = ⚥
    seq_m_laplace { sequence = <M L A P L A C E>; bindings = <&uc 0x2206 0>; };  // laplace = ∆
    seq_m_lat { sequence = <M L A T DOT>; bindings = <&uc 0x2AAB 0>; };  // lat = ⪫
    seq_m_lat_eq { sequence = <M L A T E Q>; bindings = <&uc 0x2AAD 0>; };  // lat.eq = ⪭
    seq_m_lozenge_filled_medium { sequence = <M L O Z E N G E F I L L E D M E D I U M>; bindings = <&uc 0x2B27 0>; };  // lozenge.filled.medium = ⬧
    seq_m_lt_approx { sequence = <M L T A P P R O X>; bindings = <&uc 0x2A85 0>; };  // lt.approx = ⪅
    seq_m_lt_arc { sequence = <M L T A R C DOT>; bindings = <&uc 0x2AA6 0>; };  // lt.arc = ⪦
    seq_m_lt_arc_eq { sequence = <M L T A R C E Q>; bindings = <&uc 0x2AA8 0>; };  // lt.arc.eq = ⪨
    seq_m_lt_closed { sequence = <M L T C L O S E D>; bindings = <&uc 0x22B2 0>; };  // lt.closed = ⊲
    seq_m_lt_eq { sequence = <M L T E Q DOT>; bindings = <&uc 0x2264 0>; };  // lt.eq = ≤
    seq_m_lt_eq_gt { sequence = <M L T E Q G T>; bindings = <&uc 0x22DA 0>; };  // lt.eq.gt = ⋚
    seq_m_lt_eq_not { sequence = <M L T E Q N O T>; bindings = <&uc 0x2270 0>; };  // lt.eq.not = ≰
    seq_m_lt_eq_slant { sequence = <M L T E Q S L A N T>; bindings = <&uc 0x2A7D 0>; };  // lt.eq.slant = ⩽
    seq_m_lt_equiv { sequence = <M L T E Q U I V DOT>; bindings = <&uc 0x2266 0>; };  // lt.equiv = ≦
    seq_m_lt_equiv_slant { sequence = <M L T E Q U I V S L A N T>; bindings = <&uc 0x2AF9 0>; };  // lt.equiv.slant = ⫹
    seq_m_lt_gt { sequence = <M L T G T DOT>; bindings = <&uc 0x2276 0>; };  // lt.gt = ≶
    seq_m_lt_gt_not { sequence = <M L T G T N O T>; bindings = <&uc 0x2278 0>; };  // lt.gt.not = ≸
    seq_m_lt_napprox { sequence = <M L T N A P P R O X>; bindings = <&uc 0x2A89 0>; };  // lt.napprox = ⪉
    seq_m_lt_neq { sequence = <M L T N E Q DOT>; bindings = <&uc 0x2A87 0>; };  // lt.neq = ⪇
    seq_m_lt_nequiv { sequence = <M L T N E Q U I V>; bindings = <&uc 0x2268 0>; };  // lt.nequiv = ≨
    seq_m_lt_not { sequence = <M L T N O T>; bindings = <&uc 0x226E 0>; };  // lt.not = ≮
    seq_m_lt_ntilde { sequence = <M L T N T I L D E>; bindings = <&uc 0x22E6 0>; };  // lt.ntilde = ⋦
    seq_m_lt_o { sequence = <M L T O>; bindings = <&uc 0x29C0 0>; };  // lt.o = ⧀
    seq_m_lt_quest { sequence = <M L T Q U E S T>; bindings = <&uc 0x2A7B 0>; };  // lt.quest = ⩻
    seq_m_lt_tilde { sequence = <M L T T I L D E DOT>; bindings = <&uc 0x2272 0>; };  // lt.tilde = ≲
    seq_m_lt_tilde_not { sequence = <M L T T I L D E N O T>; bindings = <&uc 0x2274 0>; };  // lt.tilde.not = ≴
    seq_m_lt_triple { sequence = <M L T T R I P L E>; bindings = <&uc 0x22D8 0>; };  // lt.triple = ⋘
    seq_m_male { sequence = <M M A L E DOT>; bindings = <&uc 0x2642 0 &uc 0xFE0E 0>; };  // male = ♂
    seq_m_male_double { sequence = <M M A L E D O U B L E>; bindings = <&uc 0x26A3 0>; };  // male.double = ⚣
    seq_m_male_female { sequence = <M M A L E F E M A L E>; bindings = <&uc 0x26A4 0>; };  // male.female = ⚤
    seq_m_maltese { sequence = <M M A L T E S E>; bindings = <&uc 0x2720 0>; };  // maltese = ✠
    seq_m_mapsfrom { sequence = <M M A P S F R O M DOT>; bindings = <&uc 0x21A4 0>; };  // mapsfrom = ↤
    seq_m_mapsfrom_long { sequence = <M M A P S F R O M L O N G>; bindings = <&uc 0x27FB 0>; };  // mapsfrom.long = ⟻
    seq_m_mapsto { sequence = <M M A P S T O DOT>; bindings = <&uc 0x21A6 0>; };  // mapsto = ↦
    seq_m_mapsto_long { sequence = <M M A P S T O L O N G>; bindings = <&uc 0x27FC 0>; };  // mapsto.long = ⟼
    seq_m_minus_o { sequence = <M M I N U S O>; bindings = <&uc 0x2296 0>; };  // minus.o = ⊖
    seq_m_minus_plus { sequence = <M M I N U S P L U S>; bindings = <&uc 0x2213 0>; };  // minus.plus = ∓
    seq_m_minus_tilde { sequence = <M M I N U S T I L D E>; bindings = <&uc 0x2242 0>; };  // minus.tilde = ≂
    seq_m_minus_triangle { sequence = <M M I N U S T R I A N G L E>; bindings = <&uc 0x2A3A 0>; };  // minus.triangle = ⨺
    seq_m_models { sequence = <M M O D E L S>; bindings = <&uc 0x22A7 0>; };  // models = ⊧
    seq_m_multimap { sequence = <M M U L T I M A P DOT>; bindings = <&uc 0x22B8 0>; };  // multimap = ⊸
    seq_m_multimap_double { sequence = <M M U L T I M A P D O U B L E>; bindings = <&uc 0x29DF 0>; };  // multimap.double = ⧟
    seq_m_nabla { sequence = <M N A B L A>; bindings = <&uc 0x2207 0>; };  // nabla = ∇
    seq_m_not { sequence = <M N O T DOT>; bindings = <&uc 0xAC 0>; };  // not = ¬
    seq_m_nothing { sequence = <M N O T H I N G DOT>; bindings = <&uc 0x2205 0>; };  // nothing = ∅
    seq_m_nothing_bar { sequence = <M N O T H I N G B A R>; bindings = <&uc 0x29B1 0>; };  // nothing.bar = ⦱
    seq_m_nothing_rev { sequence = <M N O T H I N G R E V>; bindings = <&uc 0x29B0 0>; };  // nothing.rev = ⦰
    seq_m_numero { sequence = <M N U M E R O>; bindings = <&uc 0x2116 0>; };  // numero = №
    seq_m_oo { sequence = <M O O>; bindings = <&uc 0x221E 0>; };  // oo = ∞
    seq_m_or { sequence = <M O R DOT>; bindings = <&uc 0x2228 0>; };  // or = ∨
    seq_m_or_big { sequence = <M O R B I G>; bindings = <&uc 0x22C1 0>; };  // or.big = ⋁
    seq_m_or_curly { sequence = <M O R C U R L Y>; bindings = <&uc 0x22CE 0>; };  // or.curly = ⋎
    seq_m_original { sequence = <M O R I G I N A L>; bindings = <&uc 0x22B6 0>; };  // original = ⊶
    seq_m_parallel { sequence = <M P A R A L L E L DOT>; bindings = <&uc 0x2225 0>; };  // parallel = ∥
    seq_m_parallel_eq { sequence = <M P A R A L L E L E Q DOT>; bindings = <&uc 0x22D5 0>; };  // parallel.eq = ⋕
    seq_m_parallel_equiv { sequence = <M P A R A L L E L E Q U I V>; bindings = <&uc 0x2A68 0>; };  // parallel.equiv = ⩨
    seq_m_parallel_not { sequence = <M P A R A L L E L N O T>; bindings = <&uc 0x2226 0>; };  // parallel.not = ∦
    seq_m_parallel_struck { sequence = <M P A R A L L E L S T R U C K>; bindings = <&uc 0x2AF2 0>; };  // parallel.struck = ⫲
    seq_m_parallel_tilde { sequence = <M P A R A L L E L T I L D E>; bindings = <&uc 0x2AF3 0>; };  // parallel.tilde = ⫳
    seq_m_paren_r_flat { sequence = <M P A R E N R F L A T>; bindings = <&uc 0x27EF 0>; };  // paren.r.flat = ⟯
    seq_m_partial { sequence = <M P A R T I A L>; bindings = <&uc 0x2202 0>; };  // partial = ∂
    seq_m_pee { sequence = <M P E E>; bindings = <&uc 0x2118 0>; };  // pee = ℘
    seq_m_permille { sequence = <M P E R M I L L E>; bindings = <&uc 0x2030 0>; };  // permille = ‰
    seq_m_permyriad { sequence = <M P E R M Y R I A D>; bindings = <&uc 0x2031 0>; };  // permyriad = ‱
    seq_m_perp { sequence = <M P E R P>; bindings = <&uc 0x27C2 0>; };  // perp = ⟂
    seq_m_pilcrow { sequence = <M P I L C R O W>; bindings = <&uc 0xB6 0>; };  // pilcrow = ¶
    seq_m_planck { sequence = <M P L A N C K>; bindings = <&uc 0x127 0>; };  // planck = ħ
    seq_m_plus_minus { sequence = <M P L U S M I N U S>; bindings = <&uc 0xB1 0>; };  // plus.minus = ±
    seq_m_plus_o { sequence = <M P L U S O DOT>; bindings = <&uc 0x2295 0>; };  // plus.o = ⊕
    seq_m_plus_o_big { sequence = <M P L U S O B I G>; bindings = <&uc 0x2A01 0>; };  // plus.o.big = ⨁
    seq_m_plus_square { sequence = <M P L U S S Q U A R E>; bindings = <&uc 0x229E 0>; };  // plus.square = ⊞
    seq_m_plus_triangle { sequence = <M P L U S T R I A N G L E>; bindings = <&uc 0x2A39 0>; };  // plus.triangle = ⨹
    seq_m_plus_triple { sequence = <M P L U S T R I P L E>; bindings = <&uc 0x29FB 0>; };  // plus.triple = ⧻
    seq_m_power_on { sequence = <M P O W E R O N DOT>; bindings = <&uc 0x23FD 0>; };  // power.on = ⏽
    seq_m_power_on_off { sequence = <M P O W E R O N O F F>; bindings = <&uc 0x23FC 0>; };  // power.on.off = ⏼
    seq_m_power_sleep { sequence = <M P O W E R S L E E P>; bindings = <&uc 0x23FE 0>; };  // power.sleep = ⏾
    seq_m_power_standby { sequence = <M P O W E R S T A N D B Y>; bindings = <&uc 0x23FB 0>; };  // power.standby = ⏻
    seq_m_prec { sequence = <M P R E C DOT>; bindings = <&uc 0x227A 0>; };  // prec = ≺
    seq_m_prec_approx { sequence = <M P R E C A P P R O X>; bindings = <&uc 0x2AB7 0>; };  // prec.approx = ⪷
    seq_m_prec_curly_eq { sequence = <M P R E C C U R L Y E Q DOT>; bindings = <&uc 0x227C 0>; };  // prec.curly.eq = ≼
    seq_m_prec_curly_eq_not { sequence = <M P R E C C U R L Y E Q N O T>; bindings = <&uc 0x22E0 0>; };  // prec.curly.eq.not = ⋠
    seq_m_prec_double { sequence = <M P R E C D O U B L E>; bindings = <&uc 0x2ABB 0>; };  // prec.double = ⪻
    seq_m_prec_eq { sequence = <M P R E C E Q DOT>; bindings = <&uc 0x2AAF 0>; };  // prec.eq = ⪯
    seq_m_prec_eq_slant { sequence = <M P R E C E Q S L A N T DOT>; bindings = <&uc 0x227C 0>; };  // prec.eq.slant = ≼
    seq_m_prec_eq_slant_not { sequence = <M P R E C E Q S L A N T N O T>; bindings = <&uc 0x22E0 0>; };  // prec.eq.slant.not = ⋠
    seq_m_prec_equiv { sequence = <M P R E C E Q U I V>; bindings = <&uc 0x2AB3 0>; };  // prec.equiv = ⪳
    seq_m_prec_napprox { sequence = <M P R E C N A P P R O X>; bindings = <&uc 0x2AB9 0>; };  // prec.napprox = ⪹
    seq_m_prec_neq { sequence = <M P R E C N E Q DOT>; bindings = <&uc 0x2AB1 0>; };  // prec.neq = ⪱
    seq_m_prec_nequiv { sequence = <M P R E C N E Q U I V>; bindings = <&uc 0x2AB5 0>; };  // prec.nequiv = ⪵
    seq_m_prec_not { sequence = <M P R E C N O T>; bindings = <&uc 0x2280 0>; };  // prec.not = ⊀
    seq_m_prec_ntilde { sequence = <M P R E C N T I L D E>; bindings = <&uc 0x22E8 0>; };  // prec.ntilde = ⋨
    seq_m_prec_tilde { sequence = <M P R E C T I L D E>; bindings = <&uc 0x227E 0>; };  // prec.tilde = ≾
    seq_m_product { sequence = <M P R O D U C T DOT>; bindings = <&uc 0x220F 0>; };  // product = ∏
    seq_m_product_co { sequence = <M P R O D U C T C O>; bindings = <&uc 0x2210 0>; };  // product.co = ∐
    seq_m_prop { sequence = <M P R O P>; bindings = <&uc 0x221D 0>; };  // prop = ∝
    seq_m_quest_double { sequence = <M Q U E S T D O U B L E>; bindings = <&uc 0x2047 0>; };  // quest.double = ⁇
    seq_m_quest_excl { sequence = <M Q U E S T E X C L>; bindings = <&uc 0x2048 0>; };  // quest.excl = ⁈
    seq_m_quest_inv { sequence = <M Q U E S T I N V>; bindings = <&uc 0xBF 0>; };  // quest.inv = ¿
    seq_m_ratio { sequence = <M R A T I O>; bindings = <&uc 0x2236 0>; };  // ratio = ∶
    seq_m_slash_big { sequence = <M S L A S H B I G>; bindings = <&uc 0x29F8 0>; };  // slash.big = ⧸
    seq_m_smt { sequence = <M S M T>; bindings = <&uc 0x2AAA 0>; };  // smt = ⪪
    seq_m_subset { sequence = <M S U B S E T DOT>; bindings = <&uc 0x2282 0>; };  // subset = ⊂
    seq_m_subset_approx { sequence = <M S U B S E T A P P R O X>; bindings = <&uc 0x2AC9 0>; };  // subset.approx = ⫉
    seq_m_subset_eq { sequence = <M S U B S E T E Q DOT>; bindings = <&uc 0x2286 0>; };  // subset.eq = ⊆
    seq_m_subset_eq_dot { sequence = <M S U B S E T E Q D O T>; bindings = <&uc 0x2AC3 0>; };  // subset.eq.dot = ⫃
    seq_m_subset_eq_not { sequence = <M S U B S E T E Q N O T>; bindings = <&uc 0x2288 0>; };  // subset.eq.not = ⊈
    seq_m_subset_eq_sq { sequence = <M S U B S E T E Q S Q DOT>; bindings = <&uc 0x2291 0>; };  // subset.eq.sq = ⊑
    seq_m_subset_eq_sq_not { sequence = <M S U B S E T E Q S Q N O T>; bindings = <&uc 0x22E2 0>; };  // subset.eq.sq.not = ⋢
    seq_m_subset_equiv { sequence = <M S U B S E T E Q U I V>; bindings = <&uc 0x2AC5 0>; };  // subset.equiv = ⫅
    seq_m_subset_neq { sequence = <M S U B S E T N E Q DOT>; bindings = <&uc 0x228A 0>; };  // subset.neq = ⊊
    seq_m_subset_nequiv { sequence = <M S U B S E T N E Q U I V>; bindings = <&uc 0x2ACB 0>; };  // subset.nequiv = ⫋
    seq_m_subset_not { sequence = <M S U B S E T N O T>; bindings = <&uc 0x2284 0>; };  // subset.not = ⊄
    seq_m_subset_sq { sequence = <M S U B S E T S Q DOT>; bindings = <&uc 0x228F 0>; };  // subset.sq = ⊏
    seq_m_subset_sq_neq { sequence = <M S U B S E T S Q N E Q>; bindings = <&uc 0x22E4 0>; };  // subset.sq.neq = ⋤
    seq_m_subset_tilde { sequence = <M S U B S E T T I L D E>; bindings = <&uc 0x2AC7 0>; };  // subset.tilde = ⫇
    seq_m_succ { sequence = <M S U C C DOT>; bindings = <&uc 0x227B 0>; };  // succ = ≻
    seq_m_succ_approx { sequence = <M S U C C A P P R O X>; bindings = <&uc 0x2AB8 0>; };  // succ.approx = ⪸
    seq_m_succ_curly_eq { sequence = <M S U C C C U R L Y E Q DOT>; bindings = <&uc 0x227D 0>; };  // succ.curly.eq = ≽
    seq_m_succ_curly_eq_not { sequence = <M S U C C C U R L Y E Q N O T>; bindings = <&uc 0x22E1 0>; };  // succ.curly.eq.not = ⋡
    seq_m_succ_double { sequence = <M S U C C D O U B L E>; bindings = <&uc 0x2ABC 0>; };  // succ.double = ⪼
    seq_m_succ_eq { sequence = <M S U C C E Q DOT>; bindings = <&uc 0x2AB0 0>; };  // succ.eq = ⪰
    seq_m_succ_eq_slant { sequence = <M S U C C E Q S L A N T DOT>; bindings = <&uc 0x227D 0>; };  // succ.eq.slant = ≽
    seq_m_succ_eq_slant_not { sequence = <M S U C C E Q S L A N T N O T>; bindings = <&uc 0x22E1 0>; };  // succ.eq.slant.not = ⋡
    seq_m_succ_equiv { sequence = <M S U C C E Q U I V>; bindings = <&uc 0x2AB4 0>; };  // succ.equiv = ⪴
    seq_m_succ_napprox { sequence = <M S U C C N A P P R O X>; bindings = <&uc 0x2ABA 0>; };  // succ.napprox = ⪺
    seq_m_succ_neq { sequence = <M S U C C N E Q DOT>; bindings = <&uc 0x2AB2 0>; };  // succ.neq = ⪲
    seq_m_succ_nequiv { sequence = <M S U C C N E Q U I V>; bindings = <&uc 0x2AB6 0>; };  // succ.nequiv = ⪶
    seq_m_succ_not { sequence = <M S U C C N O T>; bindings = <&uc 0x2281 0>; };  // succ.not = ⊁
    seq_m_succ_ntilde { sequence = <M S U C C N T I L D E>; bindings = <&uc 0x22E9 0>; };  // succ.ntilde = ⋩
    seq_m_succ_tilde { sequence = <M S U C C T I L D E>; bindings = <&uc 0x227F 0>; };  // succ.tilde = ≿
    seq_m_sum { sequence = <M S U M DOT>; bindings = <&uc 0x2211 0>; };  // sum = ∑
    seq_m_sum_integral { sequence = <M S U M I N T E G R A L>; bindings = <&uc 0x2A0B 0>; };  // sum.integral = ⨋
    seq_m_supset { sequence = <M S U P S E T DOT>; bindings = <&uc 0x2283 0>; };  // supset = ⊃
    seq_m_supset_approx { sequence = <M S U P S E T A P P R O X>; bindings = <&uc 0x2ACA 0>; };  // supset.approx = ⫊
    seq_m_supset_eq { sequence = <M S U P S E T E Q DOT>; bindings = <&uc 0x2287 0>; };  // supset.eq = ⊇
    seq_m_supset_eq_not { sequence = <M S U P S E T E Q N O T>; bindings = <&uc 0x2289 0>; };  // supset.eq.not = ⊉
    seq_m_supset_eq_sq { sequence = <M S U P S E T E Q S Q DOT>; bindings = <&uc 0x2292 0>; };  // supset.eq.sq = ⊒
    seq_m_supset_eq_sq_not { sequence = <M S U P S E T E Q S Q N O T>; bindings = <&uc 0x22E3 0>; };  // supset.eq.sq.not = ⋣
    seq_m_supset_equiv { sequence = <M S U P S E T E Q U I V>; bindings = <&uc 0x2AC6 0>; };  // supset.equiv = ⫆
    seq_m_supset_neq { sequence = <M S U P S E T N E Q DOT>; bindings = <&uc 0x228B 0>; };  // supset.neq = ⊋
    seq_m_supset_nequiv { sequence = <M S U P S E T N E Q U I V>; bindings = <&uc 0x2ACC 0>; };  // supset.nequiv = ⫌
    seq_m_supset_not { sequence = <M S U P S E T N O T>; bindings = <&uc 0x2285 0>; };  // supset.not = ⊅
    seq_m_supset_sq { sequence = <M S U P S E T S Q>; bindings = <&uc 0x2290 0>; };  // supset.sq = ⊐
    seq_m_supset_tilde { sequence = <M S U P S E T T I L D E>; bindings = <&uc 0x2AC8 0>; };  // supset.tilde = ⫈
    seq_m_tack_b { sequence = <M T A C K B DOT>; bindings = <&uc 0x22A4 0>; };  // tack.b = ⊤
    seq_m_tack_b_big { sequence = <M T A C K B B I G>; bindings = <&uc 0x27D9 0>; };  // tack.b.big = ⟙
    seq_m_tack_b_short { sequence = <M T A C K B S H O R T>; bindings = <&uc 0x2ADF 0>; };  // tack.b.short = ⫟
    seq_m_tack_bb { sequence = <M T A C K B B DOT>; bindings = <&uc 0x2AEA 0>; };  // tack.bb = ⫪
    seq_m_tack_l { sequence = <M T A C K L DOT>; bindings = <&uc 0x22A3 0>; };  // tack.l = ⊣
    seq_m_tack_l_double { sequence = <M T A C K L D O U B L E>; bindings = <&uc 0x2AE3 0>; };  // tack.l.double = ⫣
    seq_m_tack_l_long { sequence = <M T A C K L L O N G>; bindings = <&uc 0x27DE 0>; };  // tack.l.long = ⟞
    seq_m_tack_l_r { sequence = <M T A C K L R>; bindings = <&uc 0x27DB 0>; };  // tack.l.r = ⟛
    seq_m_tack_l_short { sequence = <M T A C K L S H O R T>; bindings = <&uc 0x2ADE 0>; };  // tack.l.short = ⫞
    seq_m_tack_ll { sequence = <M T A C K L L DOT>; bindings = <&uc 0x2AE4 0>; };  // tack.ll = ⫤
    seq_m_tack_r { sequence = <M T A C K R DOT>; bindings = <&uc 0x22A2 0>; };  // tack.r = ⊢
    seq_m_tack_r_double { sequence = <M T A C K R D O U B L E>; bindings = <&uc 0x22A9 0>; };  // tack.r.double = ⊩
    seq_m_tack_r_long { sequence = <M T A C K R L O N G>; bindings = <&uc 0x27DD 0>; };  // tack.r.long = ⟝
    seq_m_tack_r_not { sequence = <M T A C K R N O T>; bindings = <&uc 0x22AC 0>; };  // tack.r.not = ⊬
    seq_m_tack_r_short { sequence = <M T A C K R S H O R T>; bindings = <&uc 0x22A6 0>; };  // tack.r.short = ⊦
    seq_m_tack_r_triple { sequence = <M T A C K R T R I P L E>; bindings = <&uc 0x22AA 0>; };  // tack.r.triple = ⊪
    seq_m_tack_rr { sequence = <M T A C K R R DOT>; bindings = <&uc 0x22A8 0>; };  // tack.rr = ⊨
    seq_m_tack_rr_not { sequence = <M T A C K R R N O T>; bindings = <&uc 0x22AD 0>; };  // tack.rr.not = ⊭
    seq_m_tack_rr_short { sequence = <M T A C K R R S H O R T>; bindings = <&uc 0x22A7 0>; };  // tack.rr.short = ⊧
    seq_m_tack_rrr { sequence = <M T A C K R R R>; bindings = <&uc 0x2AE2 0>; };  // tack.rrr = ⫢
    seq_m_tack_t { sequence = <M T A C K T DOT>; bindings = <&uc 0x22A5 0>; };  // tack.t = ⊥
    seq_m_tack_t_big { sequence = <M T A C K T B I G>; bindings = <&uc 0x27D8 0>; };  // tack.t.big = ⟘
    seq_m_tack_t_short { sequence = <M T A C K T S H O R T>; bindings = <&uc 0x2AE0 0>; };  // tack.t.short = ⫠
    seq_m_tack_tt { sequence = <M T A C K T T>; bindings = <&uc 0x2AEB 0>; };  // tack.tt = ⫫
    seq_m_therefore { sequence = <M T H E R E F O R E>; bindings = <&uc 0x2234 0>; };  // therefore = ∴
    seq_m_times { sequence = <M T I M E S DOT>; bindings = <&uc 0xD7 0>; };  // times = ×
    seq_m_times_big { sequence = <M T I M E S B I G>; bindings = <&uc 0x2A09 0>; };  // times.big = ⨉
    seq_m_times_div { sequence = <M T I M E S D I V>; bindings = <&uc 0x22C7 0>; };  // times.div = ⋇
    seq_m_times_l { sequence = <M T I M E S L>; bindings = <&uc 0x22C9 0>; };  // times.l = ⋉
    seq_m_times_o { sequence = <M T I M E S O DOT>; bindings = <&uc 0x2297 0>; };  // times.o = ⊗
    seq_m_times_o_big { sequence = <M T I M E S O B I G>; bindings = <&uc 0x2A02 0>; };  // times.o.big = ⨂
    seq_m_times_r { sequence = <M T I M E S R>; bindings = <&uc 0x22CA 0>; };  // times.r = ⋊
    seq_m_times_three_l { sequence = <M T I M E S T H R E E L>; bindings = <&uc 0x22CB 0>; };  // times.three.l = ⋋
    seq_m_times_three_r { sequence = <M T I M E S T H R E E R>; bindings = <&uc 0x22CC 0>; };  // times.three.r = ⋌
    seq_m_times_triangle { sequence = <M T I M E S T R I A N G L E>; bindings = <&uc 0x2A3B 0>; };  // times.triangle = ⨻
    seq_m_top { sequence = <M T O P>; bindings = <&uc 0x22A4 0>; };  // top = ⊤
    seq_m_trademark { sequence = <M T R A D E M A R K DOT>; bindings = <&uc 0x2122 0 &uc 0xFE0E 0>; };  // trademark = ™
    seq_m_trademark_mc { sequence = <M T R A D E M A R K M C>; bindings = <&uc 0x1F16A 0>; };  // trademark.mc = 🅪
    seq_m_trademark_md { sequence = <M T R A D E M A R K M D>; bindings = <&uc 0x1F16B 0>; };  // trademark.md = 🅫
    seq_m_trademark_registered { sequence = <M T R A D E M A R K R E G I S T E R E D>; bindings = <&uc 0xAE 0 &uc 0xFE0E 0>; };  // trademark.registered = ®
    seq_m_trademark_service { sequence = <M T R A D E M A R K S E R V I C E>; bindings = <&uc 0x2120 0>; };  // trademark.service = ℠
    seq_m_trans { sequence = <M T R A N S>; bindings = <&uc 0x26A7 0 &uc 0xFE0E 0>; };  // trans = ⚧
    seq_m_triangle_filled_small_b { sequence = <M T R I A N G L E F I L L E D S M A L L B>; bindings = <&uc 0x25BE 0>; };  // triangle.filled.small.b = ▾
    seq_m_triangle_filled_small_l { sequence = <M T R I A N G L E F I L L E D S M A L L L>; bindings = <&uc 0x25C2 0>; };  // triangle.filled.small.l = ◂
    seq_m_triangle_filled_small_r { sequence = <M T R I A N G L E F I L L E D S M A L L R>; bindings = <&uc 0x25B8 0>; };  // triangle.filled.small.r = ▸
    seq_m_triangle_filled_small_t { sequence = <M T R I A N G L E F I L L E D S M A L L T>; bindings = <&uc 0x25B4 0>; };  // triangle.filled.small.t = ▴
    seq_m_triangle_stroked_small_b { sequence = <M T R I A N G L E S T R O K E D S M A L L B>; bindings = <&uc 0x25BF 0>; };  // triangle.stroked.small.b = ▿
    seq_m_triangle_stroked_small_l { sequence = <M T R I A N G L E S T R O K E D S M A L L L>; bindings = <&uc 0x25C3 0>; };  // triangle.stroked.small.l = ◃
    seq_m_triangle_stroked_small_r { sequence = <M T R I A N G L E S T R O K E D S M A L L R>; bindings = <&uc 0x25B9 0>; };  // triangle.stroked.small.r = ▹
    seq_m_triangle_stroked_small_t { sequence = <M T R I A N G L E S T R O K E D S M A L L T>; bindings = <&uc 0x25B5 0>; };  // triangle.stroked.small.t = ▵
    seq_m_union { sequence = <M U N I O N DOT>; bindings = <&uc 0x222A 0>; };  // union = ∪
    seq_m_union_big { sequence = <M U N I O N B I G>; bindings = <&uc 0x22C3 0>; };  // union.big = ⋃
    seq_m_union_sq { sequence = <M U N I O N S Q DOT>; bindings = <&uc 0x2294 0>; };  // union.sq = ⊔
    seq_m_union_sq_big { sequence = <M U N I O N S Q B I G>; bindings = <&uc 0x2A06 0>; };  // union.sq.big = ⨆
    seq_m_without { sequence = <M W I T H O U T>; bindings = <&uc 0x2216 0>; };  // without = ∖
    seq_m_xor { sequence = <M X O R DOT>; bindings = <&uc 0x2295 0>; };  // xor = ⊕
    seq_m_xor_big { sequence = <M X O R B I G>; bindings = <&uc 0x2A01 0>; };  // xor.big = ⨁

    /* --- available but disabled (499) ---
     * Uncomment a line to enable it. Each is disabled because it is
     * beyond the active limit, or its spelling is an exact duplicate of
     * another name (typst's `alpha` and `Alpha`, which no punctuation
     * can separate).
     *
     * NOTE: a name that is a PREFIX of an enabled one needs a trailing
     * DOT appended before it will work - otherwise the shorter sequence
     * fires first and the longer becomes unreachable. Re-running the
     * generator adds those automatically; a hand-uncommented line does
     * not get one.
     */
    // seq_m_AA { sequence = <M A A>; bindings = <&uc 0x1D538 0>; };  // AA = 𝔸
    // seq_m_BB { sequence = <M B B>; bindings = <&uc 0x1D539 0>; };  // BB = 𝔹
    // seq_m_CC { sequence = <M C C>; bindings = <&uc 0x2102 0>; };  // CC = ℂ
    // seq_m_DD { sequence = <M D D>; bindings = <&uc 0x1D53B 0>; };  // DD = 𝔻
    // seq_m_EE { sequence = <M E E>; bindings = <&uc 0x1D53C 0>; };  // EE = 𝔼
    // seq_m_FF { sequence = <M F F>; bindings = <&uc 0x1D53D 0>; };  // FF = 𝔽
    // seq_m_GG { sequence = <M G G>; bindings = <&uc 0x1D53E 0>; };  // GG = 𝔾
    // seq_m_HH { sequence = <M H H>; bindings = <&uc 0x210D 0>; };  // HH = ℍ
    // seq_m_II { sequence = <M I I>; bindings = <&uc 0x1D540 0>; };  // II = 𝕀
    // seq_m_JJ { sequence = <M J J>; bindings = <&uc 0x1D541 0>; };  // JJ = 𝕁
    // seq_m_KK { sequence = <M K K>; bindings = <&uc 0x1D542 0>; };  // KK = 𝕂
    // seq_m_LL { sequence = <M L L>; bindings = <&uc 0x1D543 0>; };  // LL = 𝕃
    // seq_m_MM { sequence = <M M M>; bindings = <&uc 0x1D544 0>; };  // MM = 𝕄
    // seq_m_OO { sequence = <M O O>; bindings = <&uc 0x1D546 0>; };  // OO = 𝕆
    // seq_m_PP { sequence = <M P P>; bindings = <&uc 0x2119 0>; };  // PP = ℙ
    // seq_m_SS { sequence = <M S S>; bindings = <&uc 0x1D54A 0>; };  // SS = 𝕊
    // seq_m_TT { sequence = <M T T>; bindings = <&uc 0x1D54B 0>; };  // TT = 𝕋
    // seq_m_UU { sequence = <M U U>; bindings = <&uc 0x1D54C 0>; };  // UU = 𝕌
    // seq_m_VV { sequence = <M V V>; bindings = <&uc 0x1D54D 0>; };  // VV = 𝕍
    // seq_m_WW { sequence = <M W W>; bindings = <&uc 0x1D54E 0>; };  // WW = 𝕎
    // seq_m_XX { sequence = <M X X>; bindings = <&uc 0x1D54F 0>; };  // XX = 𝕏
    // seq_m_YY { sequence = <M Y Y>; bindings = <&uc 0x1D550 0>; };  // YY = 𝕐
    // seq_m_aleph { sequence = <M A L E P H>; bindings = <&uc 0x5D0 0>; };  // aleph = א
    // seq_m_amp { sequence = <M A M P>; bindings = <&uc 0x26 0>; };  // amp = &
    // seq_m_and_dot { sequence = <M A N D D O T>; bindings = <&uc 0x27D1 0>; };  // and.dot = ⟑
    // seq_m_and_double { sequence = <M A N D D O U B L E>; bindings = <&uc 0x2A53 0>; };  // and.double = ⩓
    // seq_m_angle_right_arc { sequence = <M A N G L E R I G H T A R C>; bindings = <&uc 0x22BE 0>; };  // angle.right.arc = ⊾
    // seq_m_angle_right_dot { sequence = <M A N G L E R I G H T D O T>; bindings = <&uc 0x299D 0>; };  // angle.right.dot = ⦝
    // seq_m_angle_right_rev { sequence = <M A N G L E R I G H T R E V>; bindings = <&uc 0x2BFE 0>; };  // angle.right.rev = ⯾
    // seq_m_angle_right_square { sequence = <M A N G L E R I G H T S Q U A R E>; bindings = <&uc 0x299C 0>; };  // angle.right.square = ⦜
    // seq_m_angle_spheric_rev { sequence = <M A N G L E S P H E R I C R E V>; bindings = <&uc 0x29A0 0>; };  // angle.spheric.rev = ⦠
    // seq_m_angle_spheric_t { sequence = <M A N G L E S P H E R I C T>; bindings = <&uc 0x29A1 0>; };  // angle.spheric.t = ⦡
    // seq_m_approx_hat { sequence = <M A P P R O X H A T>; bindings = <&uc 0x2A6F 0>; };  // approx.hat = ⩯
    // seq_m_arrow_b_dstruck { sequence = <M A R R O W B D S T R U C K>; bindings = <&uc 0x21DF 0>; };  // arrow.b.dstruck = ⇟
    // seq_m_arrow_b_twohead { sequence = <M A R R O W B T W O H E A D>; bindings = <&uc 0x21A1 0>; };  // arrow.b.twohead = ↡
    // seq_m_arrow_bl_bar { sequence = <M A R R O W B L B A R>; bindings = <&uc 0x1F8BB 0>; };  // arrow.bl.bar = 🢻
    // seq_m_arrow_br_bar { sequence = <M A R R O W B R B A R>; bindings = <&uc 0x1F8BA 0>; };  // arrow.br.bar = 🢺
    // seq_m_arrow_l_double_bar { sequence = <M A R R O W L D O U B L E B A R>; bindings = <&uc 0x2906 0>; };  // arrow.l.double.bar = ⤆
    // seq_m_arrow_l_double_not { sequence = <M A R R O W L D O U B L E N O T>; bindings = <&uc 0x21CD 0>; };  // arrow.l.double.not = ⇍
    // seq_m_arrow_l_double_struck { sequence = <M A R R O W L D O U B L E S T R U C K>; bindings = <&uc 0x2902 0>; };  // arrow.l.double.struck = ⤂
    // seq_m_arrow_l_dstruck { sequence = <M A R R O W L D S T R U C K>; bindings = <&uc 0x21FA 0>; };  // arrow.l.dstruck = ⇺
    // seq_m_arrow_l_long_bar { sequence = <M A R R O W L L O N G B A R>; bindings = <&uc 0x27FB 0>; };  // arrow.l.long.bar = ⟻
    // seq_m_arrow_l_r_dstruck { sequence = <M A R R O W L R D S T R U C K>; bindings = <&uc 0x21FC 0>; };  // arrow.l.r.dstruck = ⇼
    // seq_m_arrow_l_r_long { sequence = <M A R R O W L R L O N G>; bindings = <&uc 0x27F7 0>; };  // arrow.l.r.long = ⟷
    // seq_m_arrow_l_r_not { sequence = <M A R R O W L R N O T>; bindings = <&uc 0x21AE 0>; };  // arrow.l.r.not = ↮
    // seq_m_arrow_l_r_open { sequence = <M A R R O W L R O P E N>; bindings = <&uc 0x21FF 0>; };  // arrow.l.r.open = ⇿
    // seq_m_arrow_l_r_struck { sequence = <M A R R O W L R S T R U C K>; bindings = <&uc 0x21F9 0>; };  // arrow.l.r.struck = ⇹
    // seq_m_arrow_l_r_wave { sequence = <M A R R O W L R W A V E>; bindings = <&uc 0x21AD 0>; };  // arrow.l.r.wave = ↭
    // seq_m_arrow_l_tail_dstruck { sequence = <M A R R O W L T A I L D S T R U C K>; bindings = <&uc 0x2B3A 0>; };  // arrow.l.tail.dstruck = ⬺
    // seq_m_arrow_l_tail_struck { sequence = <M A R R O W L T A I L S T R U C K>; bindings = <&uc 0x2B39 0>; };  // arrow.l.tail.struck = ⬹
    // seq_m_arrow_l_twohead { sequence = <M A R R O W L T W O H E A D>; bindings = <&uc 0x219E 0>; };  // arrow.l.twohead = ↞
    // seq_m_arrow_l_twohead_bar { sequence = <M A R R O W L T W O H E A D B A R>; bindings = <&uc 0x2B36 0>; };  // arrow.l.twohead.bar = ⬶
    // seq_m_arrow_l_twohead_dstruck { sequence = <M A R R O W L T W O H E A D D S T R U C K>; bindings = <&uc 0x2B35 0>; };  // arrow.l.twohead.dstruck = ⬵
    // seq_m_arrow_l_twohead_struck { sequence = <M A R R O W L T W O H E A D S T R U C K>; bindings = <&uc 0x2B34 0>; };  // arrow.l.twohead.struck = ⬴
    // seq_m_arrow_l_twohead_tail { sequence = <M A R R O W L T W O H E A D T A I L>; bindings = <&uc 0x2B3B 0>; };  // arrow.l.twohead.tail = ⬻
    // seq_m_arrow_l_twohead_tail_dstruck { sequence = <M A R R O W L T W O H E A D T A I L D S T R U C K>; bindings = <&uc 0x2B3D 0>; };  // arrow.l.twohead.tail.dstruck = ⬽
    // seq_m_arrow_l_twohead_tail_struck { sequence = <M A R R O W L T W O H E A D T A I L S T R U C K>; bindings = <&uc 0x2B3C 0>; };  // arrow.l.twohead.tail.struck = ⬼
    // seq_m_arrow_r_double_bar { sequence = <M A R R O W R D O U B L E B A R>; bindings = <&uc 0x2907 0>; };  // arrow.r.double.bar = ⤇
    // seq_m_arrow_r_double_not { sequence = <M A R R O W R D O U B L E N O T>; bindings = <&uc 0x21CF 0>; };  // arrow.r.double.not = ⇏
    // seq_m_arrow_r_double_struck { sequence = <M A R R O W R D O U B L E S T R U C K>; bindings = <&uc 0x2903 0>; };  // arrow.r.double.struck = ⤃
    // seq_m_arrow_r_dstruck { sequence = <M A R R O W R D S T R U C K>; bindings = <&uc 0x21FB 0>; };  // arrow.r.dstruck = ⇻
    // seq_m_arrow_r_long_bar { sequence = <M A R R O W R L O N G B A R>; bindings = <&uc 0x27FC 0>; };  // arrow.r.long.bar = ⟼
    // seq_m_arrow_r_tail_dstruck { sequence = <M A R R O W R T A I L D S T R U C K>; bindings = <&uc 0x2915 0>; };  // arrow.r.tail.dstruck = ⤕
    // seq_m_arrow_r_tail_struck { sequence = <M A R R O W R T A I L S T R U C K>; bindings = <&uc 0x2914 0>; };  // arrow.r.tail.struck = ⤔
    // seq_m_arrow_r_twohead { sequence = <M A R R O W R T W O H E A D>; bindings = <&uc 0x21A0 0>; };  // arrow.r.twohead = ↠
    // seq_m_arrow_r_twohead_bar { sequence = <M A R R O W R T W O H E A D B A R>; bindings = <&uc 0x2905 0>; };  // arrow.r.twohead.bar = ⤅
    // seq_m_arrow_r_twohead_dstruck { sequence = <M A R R O W R T W O H E A D D S T R U C K>; bindings = <&uc 0x2901 0>; };  // arrow.r.twohead.dstruck = ⤁
    // seq_m_arrow_r_twohead_struck { sequence = <M A R R O W R T W O H E A D S T R U C K>; bindings = <&uc 0x2900 0>; };  // arrow.r.twohead.struck = ⤀
    // seq_m_arrow_r_twohead_tail { sequence = <M A R R O W R T W O H E A D T A I L>; bindings = <&uc 0x2916 0>; };  // arrow.r.twohead.tail = ⤖
    // seq_m_arrow_r_twohead_tail_dstruck { sequence = <M A R R O W R T W O H E A D T A I L D S T R U C K>; bindings = <&uc 0x2918 0>; };  // arrow.r.twohead.tail.dstruck = ⤘
    // seq_m_arrow_r_twohead_tail_struck { sequence = <M A R R O W R T W O H E A D T A I L S T R U C K>; bindings = <&uc 0x2917 0>; };  // arrow.r.twohead.tail.struck = ⤗
    // seq_m_arrow_t_dstruck { sequence = <M A R R O W T D S T R U C K>; bindings = <&uc 0x21DE 0>; };  // arrow.t.dstruck = ⇞
    // seq_m_arrow_t_struck { sequence = <M A R R O W T S T R U C K>; bindings = <&uc 0x2909 0>; };  // arrow.t.struck = ⤉
    // seq_m_arrow_t_triple { sequence = <M A R R O W T T R I P L E>; bindings = <&uc 0x290A 0>; };  // arrow.t.triple = ⤊
    // seq_m_arrow_t_twohead { sequence = <M A R R O W T T W O H E A D>; bindings = <&uc 0x219F 0>; };  // arrow.t.twohead = ↟
    // seq_m_arrow_tl_bar { sequence = <M A R R O W T L B A R>; bindings = <&uc 0x1F8B8 0>; };  // arrow.tl.bar = 🢸
    // seq_m_arrow_tr_bar { sequence = <M A R R O W T R B A R>; bindings = <&uc 0x1F8B9 0>; };  // arrow.tr.bar = 🢹
    // seq_m_arrows_rl_long { sequence = <M A R R O W S R L L O N G>; bindings = <&uc 0x1F8D0 0>; };  // arrows.rl.long = 🣐
    // seq_m_ast_basic { sequence = <M A S T B A S I C>; bindings = <&uc 0x2A 0 &uc 0xFE0E 0>; };  // ast.basic = *
    // seq_m_ast_double { sequence = <M A S T D O U B L E>; bindings = <&uc 0x2051 0>; };  // ast.double = ⁑
    // seq_m_ast_low { sequence = <M A S T L O W>; bindings = <&uc 0x204E 0>; };  // ast.low = ⁎
    // seq_m_ast_op { sequence = <M A S T O P>; bindings = <&uc 0x2217 0>; };  // ast.op = ∗
    // seq_m_ast_op_o { sequence = <M A S T O P O>; bindings = <&uc 0x229B 0>; };  // ast.op.o = ⊛
    // seq_m_ast_square { sequence = <M A S T S Q U A R E>; bindings = <&uc 0x29C6 0>; };  // ast.square = ⧆
    // seq_m_ast_triple { sequence = <M A S T T R I P L E>; bindings = <&uc 0x2042 0>; };  // ast.triple = ⁂
    // seq_m_at { sequence = <M A T>; bindings = <&uc 0x40 0>; };  // at = @
    // seq_m_backslash { sequence = <M B A C K S L A S H>; bindings = <&uc 0x5C 0>; };  // backslash = \
    // seq_m_backslash_not { sequence = <M B A C K S L A S H N O T>; bindings = <&uc 0x29F7 0>; };  // backslash.not = ⧷
    // seq_m_backslash_o { sequence = <M B A C K S L A S H O>; bindings = <&uc 0x29B8 0>; };  // backslash.o = ⦸
    // seq_m_bag_l { sequence = <M B A G L>; bindings = <&uc 0x27C5 0>; };  // bag.l = ⟅
    // seq_m_bag_r { sequence = <M B A G R>; bindings = <&uc 0x27C6 0>; };  // bag.r = ⟆
    // seq_m_ballot { sequence = <M B A L L O T>; bindings = <&uc 0x2610 0>; };  // ballot = ☐
    // seq_m_ballot_check { sequence = <M B A L L O T C H E C K>; bindings = <&uc 0x2611 0 &uc 0xFE0E 0>; };  // ballot.check = ☑
    // seq_m_ballot_check_heavy { sequence = <M B A L L O T C H E C K H E A V Y>; bindings = <&uc 0x1F5F9 0>; };  // ballot.check.heavy = 🗹
    // seq_m_ballot_cross { sequence = <M B A L L O T C R O S S>; bindings = <&uc 0x2612 0>; };  // ballot.cross = ☒
    // seq_m_bar_h { sequence = <M B A R H>; bindings = <&uc 0x2015 0>; };  // bar.h = ―
    // seq_m_bar_v { sequence = <M B A R V>; bindings = <&uc 0x7C 0>; };  // bar.v = |
    // seq_m_bar_v_broken { sequence = <M B A R V B R O K E N>; bindings = <&uc 0xA6 0>; };  // bar.v.broken = ¦
    // seq_m_bar_v_double { sequence = <M B A R V D O U B L E>; bindings = <&uc 0x2016 0>; };  // bar.v.double = ‖
    // seq_m_bar_v_o { sequence = <M B A R V O>; bindings = <&uc 0x29B6 0>; };  // bar.v.o = ⦶
    // seq_m_bar_v_triple { sequence = <M B A R V T R I P L E>; bindings = <&uc 0x2980 0>; };  // bar.v.triple = ⦀
    // seq_m_beth { sequence = <M B E T H>; bindings = <&uc 0x5D1 0>; };  // beth = ב
    // seq_m_bishop_black { sequence = <M B I S H O P B L A C K>; bindings = <&uc 0x265D 0>; };  // bishop.black = ♝
    // seq_m_bishop_white { sequence = <M B I S H O P W H I T E>; bindings = <&uc 0x2657 0>; };  // bishop.white = ♗
    // seq_m_bowtie_filled { sequence = <M B O W T I E F I L L E D>; bindings = <&uc 0x29D3 0>; };  // bowtie.filled = ⧓
    // seq_m_bowtie_filled_l { sequence = <M B O W T I E F I L L E D L>; bindings = <&uc 0x29D1 0>; };  // bowtie.filled.l = ⧑
    // seq_m_bowtie_filled_r { sequence = <M B O W T I E F I L L E D R>; bindings = <&uc 0x29D2 0>; };  // bowtie.filled.r = ⧒
    // seq_m_bowtie_stroked { sequence = <M B O W T I E S T R O K E D>; bindings = <&uc 0x22C8 0>; };  // bowtie.stroked = ⋈
    // seq_m_bowtie_stroked_big { sequence = <M B O W T I E S T R O K E D B I G>; bindings = <&uc 0x2A1D 0>; };  // bowtie.stroked.big = ⨝
    // seq_m_bowtie_stroked_big_l { sequence = <M B O W T I E S T R O K E D B I G L>; bindings = <&uc 0x27D5 0>; };  // bowtie.stroked.big.l = ⟕
    // seq_m_bowtie_stroked_big_l_r { sequence = <M B O W T I E S T R O K E D B I G L R>; bindings = <&uc 0x27D7 0>; };  // bowtie.stroked.big.l.r = ⟗
    // seq_m_bowtie_stroked_big_r { sequence = <M B O W T I E S T R O K E D B I G R>; bindings = <&uc 0x27D6 0>; };  // bowtie.stroked.big.r = ⟖
    // seq_m_brace_l { sequence = <M B R A C E L>; bindings = <&uc 0x7B 0>; };  // brace.l = {
    // seq_m_brace_r { sequence = <M B R A C E R>; bindings = <&uc 0x7D 0>; };  // brace.r = }
    // seq_m_bracket_b { sequence = <M B R A C K E T B>; bindings = <&uc 0x23B5 0>; };  // bracket.b = ⎵
    // seq_m_bracket_l { sequence = <M B R A C K E T L>; bindings = <&uc 0x5B 0>; };  // bracket.l = [
    // seq_m_bracket_l_tick_b { sequence = <M B R A C K E T L T I C K B>; bindings = <&uc 0x298F 0>; };  // bracket.l.tick.b = ⦏
    // seq_m_bracket_l_tick_t { sequence = <M B R A C K E T L T I C K T>; bindings = <&uc 0x298D 0>; };  // bracket.l.tick.t = ⦍
    // seq_m_bracket_r { sequence = <M B R A C K E T R>; bindings = <&uc 0x5D 0>; };  // bracket.r = ]
    // seq_m_bracket_r_tick_b { sequence = <M B R A C K E T R T I C K B>; bindings = <&uc 0x298E 0>; };  // bracket.r.tick.b = ⦎
    // seq_m_bracket_r_tick_t { sequence = <M B R A C K E T R T I C K T>; bindings = <&uc 0x2990 0>; };  // bracket.r.tick.t = ⦐
    // seq_m_bracket_t { sequence = <M B R A C K E T T>; bindings = <&uc 0x23B4 0>; };  // bracket.t = ⎴
    // seq_m_bullet { sequence = <M B U L L E T>; bindings = <&uc 0x2022 0>; };  // bullet = •
    // seq_m_bullet_hole { sequence = <M B U L L E T H O L E>; bindings = <&uc 0x25D8 0>; };  // bullet.hole = ◘
    // seq_m_bullet_hyph { sequence = <M B U L L E T H Y P H>; bindings = <&uc 0x2043 0>; };  // bullet.hyph = ⁃
    // seq_m_bullet_l { sequence = <M B U L L E T L>; bindings = <&uc 0x204C 0>; };  // bullet.l = ⁌
    // seq_m_bullet_o { sequence = <M B U L L E T O>; bindings = <&uc 0x29BF 0>; };  // bullet.o = ⦿
    // seq_m_bullet_op { sequence = <M B U L L E T O P>; bindings = <&uc 0x2219 0>; };  // bullet.op = ∙
    // seq_m_bullet_r { sequence = <M B U L L E T R>; bindings = <&uc 0x204D 0>; };  // bullet.r = ⁍
    // seq_m_bullet_stroked { sequence = <M B U L L E T S T R O K E D>; bindings = <&uc 0x25E6 0>; };  // bullet.stroked = ◦
    // seq_m_bullet_stroked_o { sequence = <M B U L L E T S T R O K E D O>; bindings = <&uc 0x29BE 0>; };  // bullet.stroked.o = ⦾
    // seq_m_bullet_tri { sequence = <M B U L L E T T R I>; bindings = <&uc 0x2023 0>; };  // bullet.tri = ‣
    // seq_m_cc { sequence = <M C C>; bindings = <&uc 0x1F16D 0>; };  // cc = 🅭
    // seq_m_ceil_l { sequence = <M C E I L L>; bindings = <&uc 0x2308 0>; };  // ceil.l = ⌈
    // seq_m_ceil_r { sequence = <M C E I L R>; bindings = <&uc 0x2309 0>; };  // ceil.r = ⌉
    // seq_m_chevron_l { sequence = <M C H E V R O N L>; bindings = <&uc 0x27E8 0>; };  // chevron.l = ⟨
    // seq_m_chevron_l_closed { sequence = <M C H E V R O N L C L O S E D>; bindings = <&uc 0x2989 0>; };  // chevron.l.closed = ⦉
    // seq_m_chevron_l_dot { sequence = <M C H E V R O N L D O T>; bindings = <&uc 0x2991 0>; };  // chevron.l.dot = ⦑
    // seq_m_chevron_l_double { sequence = <M C H E V R O N L D O U B L E>; bindings = <&uc 0x27EA 0>; };  // chevron.l.double = ⟪
    // seq_m_chevron_r { sequence = <M C H E V R O N R>; bindings = <&uc 0x27E9 0>; };  // chevron.r = ⟩
    // seq_m_chevron_r_closed { sequence = <M C H E V R O N R C L O S E D>; bindings = <&uc 0x298A 0>; };  // chevron.r.closed = ⦊
    // seq_m_chevron_r_dot { sequence = <M C H E V R O N R D O T>; bindings = <&uc 0x2992 0>; };  // chevron.r.dot = ⦒
    // seq_m_chevron_r_double { sequence = <M C H E V R O N R D O U B L E>; bindings = <&uc 0x27EB 0>; };  // chevron.r.double = ⟫
    // seq_m_circle_dotted { sequence = <M C I R C L E D O T T E D>; bindings = <&uc 0x25CC 0>; };  // circle.dotted = ◌
    // seq_m_circle_filled { sequence = <M C I R C L E F I L L E D>; bindings = <&uc 0x25CF 0>; };  // circle.filled = ●
    // seq_m_circle_filled_big { sequence = <M C I R C L E F I L L E D B I G>; bindings = <&uc 0x2B24 0>; };  // circle.filled.big = ⬤
    // seq_m_circle_filled_small { sequence = <M C I R C L E F I L L E D S M A L L>; bindings = <&uc 0x2219 0>; };  // circle.filled.small = ∙
    // seq_m_circle_filled_tiny { sequence = <M C I R C L E F I L L E D T I N Y>; bindings = <&uc 0x2981 0>; };  // circle.filled.tiny = ⦁
    // seq_m_circle_stroked { sequence = <M C I R C L E S T R O K E D>; bindings = <&uc 0x25CB 0>; };  // circle.stroked = ○
    // seq_m_circle_stroked_big { sequence = <M C I R C L E S T R O K E D B I G>; bindings = <&uc 0x25EF 0>; };  // circle.stroked.big = ◯
    // seq_m_circle_stroked_small { sequence = <M C I R C L E S T R O K E D S M A L L>; bindings = <&uc 0x26AC 0>; };  // circle.stroked.small = ⚬
    // seq_m_circle_stroked_tiny { sequence = <M C I R C L E S T R O K E D T I N Y>; bindings = <&uc 0x2218 0>; };  // circle.stroked.tiny = ∘
    // seq_m_colon { sequence = <M C O L O N>; bindings = <&uc 0x3A 0>; };  // colon = :
    // seq_m_colon_currency { sequence = <M C O L O N C U R R E N C Y>; bindings = <&uc 0x20A1 0>; };  // colon.currency = ₡
    // seq_m_colon_double { sequence = <M C O L O N D O U B L E>; bindings = <&uc 0x2237 0>; };  // colon.double = ∷
    // seq_m_colon_double_eq { sequence = <M C O L O N D O U B L E E Q>; bindings = <&uc 0x2A74 0>; };  // colon.double.eq = ⩴
    // seq_m_colon_tri { sequence = <M C O L O N T R I>; bindings = <&uc 0x205D 0>; };  // colon.tri = ⁝
    // seq_m_colon_tri_op { sequence = <M C O L O N T R I O P>; bindings = <&uc 0x2AF6 0>; };  // colon.tri.op = ⫶
    // seq_m_comma { sequence = <M C O M M A>; bindings = <&uc 0x2C 0>; };  // comma = ,
    // seq_m_comma_inv { sequence = <M C O M M A I N V>; bindings = <&uc 0x2E32 0>; };  // comma.inv = ⸲
    // seq_m_comma_rev { sequence = <M C O M M A R E V>; bindings = <&uc 0x2E41 0>; };  // comma.rev = ⹁
    // seq_m_compose_o { sequence = <M C O M P O S E O>; bindings = <&uc 0x229A 0>; };  // compose.o = ⊚
    // seq_m_corner_l_b { sequence = <M C O R N E R L B>; bindings = <&uc 0x231E 0>; };  // corner.l.b = ⌞
    // seq_m_corner_l_t { sequence = <M C O R N E R L T>; bindings = <&uc 0x231C 0>; };  // corner.l.t = ⌜
    // seq_m_corner_r_b { sequence = <M C O R N E R R B>; bindings = <&uc 0x231F 0>; };  // corner.r.b = ⌟
    // seq_m_corner_r_t { sequence = <M C O R N E R R T>; bindings = <&uc 0x231D 0>; };  // corner.r.t = ⌝
    // seq_m_dagger_double { sequence = <M D A G G E R D O U B L E>; bindings = <&uc 0x2021 0>; };  // dagger.double = ‡
    // seq_m_dagger_inv { sequence = <M D A G G E R I N V>; bindings = <&uc 0x2E38 0>; };  // dagger.inv = ⸸
    // seq_m_dagger_l { sequence = <M D A G G E R L>; bindings = <&uc 0x2E36 0>; };  // dagger.l = ⸶
    // seq_m_dagger_r { sequence = <M D A G G E R R>; bindings = <&uc 0x2E37 0>; };  // dagger.r = ⸷
    // seq_m_dagger_triple { sequence = <M D A G G E R T R I P L E>; bindings = <&uc 0x2E4B 0>; };  // dagger.triple = ⹋
    // seq_m_daleth { sequence = <M D A L E T H>; bindings = <&uc 0x5D3 0>; };  // daleth = ד
    // seq_m_dash_colon { sequence = <M D A S H C O L O N>; bindings = <&uc 0x2239 0>; };  // dash.colon = ∹
    // seq_m_dash_em { sequence = <M D A S H E M>; bindings = <&uc 0x2014 0>; };  // dash.em = —
    // seq_m_dash_em_three { sequence = <M D A S H E M T H R E E>; bindings = <&uc 0x2E3B 0>; };  // dash.em.three = ⸻
    // seq_m_dash_em_two { sequence = <M D A S H E M T W O>; bindings = <&uc 0x2E3A 0>; };  // dash.em.two = ⸺
    // seq_m_dash_en { sequence = <M D A S H E N>; bindings = <&uc 0x2013 0>; };  // dash.en = –
    // seq_m_dash_fig { sequence = <M D A S H F I G>; bindings = <&uc 0x2012 0>; };  // dash.fig = ‒
    // seq_m_dash_o { sequence = <M D A S H O>; bindings = <&uc 0x229D 0>; };  // dash.o = ⊝
    // seq_m_dash_wave { sequence = <M D A S H W A V E>; bindings = <&uc 0x301C 0>; };  // dash.wave = 〜
    // seq_m_diameter { sequence = <M D I A M E T E R>; bindings = <&uc 0x2300 0>; };  // diameter = ⌀
    // seq_m_diamond_filled { sequence = <M D I A M O N D F I L L E D>; bindings = <&uc 0x25C6 0>; };  // diamond.filled = ◆
    // seq_m_diamond_filled_small { sequence = <M D I A M O N D F I L L E D S M A L L>; bindings = <&uc 0x2B29 0>; };  // diamond.filled.small = ⬩
    // seq_m_diamond_stroked { sequence = <M D I A M O N D S T R O K E D>; bindings = <&uc 0x25C7 0>; };  // diamond.stroked = ◇
    // seq_m_diamond_stroked_dot { sequence = <M D I A M O N D S T R O K E D D O T>; bindings = <&uc 0x27D0 0>; };  // diamond.stroked.dot = ⟐
    // seq_m_diamond_stroked_medium { sequence = <M D I A M O N D S T R O K E D M E D I U M>; bindings = <&uc 0x2B26 0>; };  // diamond.stroked.medium = ⬦
    // seq_m_diamond_stroked_small { sequence = <M D I A M O N D S T R O K E D S M A L L>; bindings = <&uc 0x22C4 0>; };  // diamond.stroked.small = ⋄
    // seq_m_die_five { sequence = <M D I E F I V E>; bindings = <&uc 0x2684 0>; };  // die.five = ⚄
    // seq_m_die_four { sequence = <M D I E F O U R>; bindings = <&uc 0x2683 0>; };  // die.four = ⚃
    // seq_m_die_one { sequence = <M D I E O N E>; bindings = <&uc 0x2680 0>; };  // die.one = ⚀
    // seq_m_die_six { sequence = <M D I E S I X>; bindings = <&uc 0x2685 0>; };  // die.six = ⚅
    // seq_m_die_three { sequence = <M D I E T H R E E>; bindings = <&uc 0x2682 0>; };  // die.three = ⚂
    // seq_m_die_two { sequence = <M D I E T W O>; bindings = <&uc 0x2681 0>; };  // die.two = ⚁
    // seq_m_divides { sequence = <M D I V I D E S>; bindings = <&uc 0x2223 0>; };  // divides = ∣
    // seq_m_divides_not { sequence = <M D I V I D E S N O T>; bindings = <&uc 0x2224 0>; };  // divides.not = ∤
    // seq_m_divides_not_rev { sequence = <M D I V I D E S N O T R E V>; bindings = <&uc 0x2AEE 0>; };  // divides.not.rev = ⫮
    // seq_m_divides_struck { sequence = <M D I V I D E S S T R U C K>; bindings = <&uc 0x27CA 0>; };  // divides.struck = ⟊
    // seq_m_dot_basic { sequence = <M D O T B A S I C>; bindings = <&uc 0x2E 0>; };  // dot.basic = .
    // seq_m_dot_c { sequence = <M D O T C>; bindings = <&uc 0xB7 0>; };  // dot.c = ·
    // seq_m_dot_double { sequence = <M D O T D O U B L E>; bindings = <&uc 0xA8 0>; };  // dot.double = ¨
    // seq_m_dot_o { sequence = <M D O T O>; bindings = <&uc 0x2299 0>; };  // dot.o = ⊙
    // seq_m_dot_op { sequence = <M D O T O P>; bindings = <&uc 0x22C5 0>; };  // dot.op = ⋅
    // seq_m_dot_quad { sequence = <M D O T Q U A D>; bindings = <&uc 0x20DC 0>; };  // dot.quad = ◌⃜
    // seq_m_dot_square { sequence = <M D O T S Q U A R E>; bindings = <&uc 0x22A1 0>; };  // dot.square = ⊡
    // seq_m_dot_triple { sequence = <M D O T T R I P L E>; bindings = <&uc 0x20DB 0>; };  // dot.triple = ◌⃛
    // seq_m_dotless_i { sequence = <M D O T L E S S I>; bindings = <&uc 0x131 0>; };  // dotless.i = ı
    // seq_m_dotless_j { sequence = <M D O T L E S S J>; bindings = <&uc 0x237 0>; };  // dotless.j = ȷ
    // seq_m_dots_down { sequence = <M D O T S D O W N>; bindings = <&uc 0x22F1 0>; };  // dots.down = ⋱
    // seq_m_dots_h { sequence = <M D O T S H>; bindings = <&uc 0x2026 0>; };  // dots.h = …
    // seq_m_dots_h_c { sequence = <M D O T S H C>; bindings = <&uc 0x22EF 0>; };  // dots.h.c = ⋯
    // seq_m_dots_up { sequence = <M D O T S U P>; bindings = <&uc 0x22F0 0>; };  // dots.up = ⋰
    // seq_m_dots_v { sequence = <M D O T S V>; bindings = <&uc 0x22EE 0>; };  // dots.v = ⋮
    // seq_m_ellipse_filled_h { sequence = <M E L L I P S E F I L L E D H>; bindings = <&uc 0x2B2C 0>; };  // ellipse.filled.h = ⬬
    // seq_m_ellipse_filled_v { sequence = <M E L L I P S E F I L L E D V>; bindings = <&uc 0x2B2E 0>; };  // ellipse.filled.v = ⬮
    // seq_m_ellipse_stroked_h { sequence = <M E L L I P S E S T R O K E D H>; bindings = <&uc 0x2B2D 0>; };  // ellipse.stroked.h = ⬭
    // seq_m_ellipse_stroked_v { sequence = <M E L L I P S E S T R O K E D V>; bindings = <&uc 0x2B2F 0>; };  // ellipse.stroked.v = ⬯
    // seq_m_emptyset_arrow_l { sequence = <M E M P T Y S E T A R R O W L>; bindings = <&uc 0x29B4 0>; };  // emptyset.arrow.l = ⦴
    // seq_m_emptyset_arrow_r { sequence = <M E M P T Y S E T A R R O W R>; bindings = <&uc 0x29B3 0>; };  // emptyset.arrow.r = ⦳
    // seq_m_emptyset_circle { sequence = <M E M P T Y S E T C I R C L E>; bindings = <&uc 0x29B2 0>; };  // emptyset.circle = ⦲
    // seq_m_emptyset_zero { sequence = <M E M P T Y S E T Z E R O>; bindings = <&uc 0x2205 0 &uc 0x5C 0 &uc 0x76 0 &uc 0x73 0 &uc 0x7B 0 &uc 0x31 0 &uc 0x7D 0>; };  // emptyset.zero = ∅\vs{1}
    // seq_m_eq { sequence = <M E Q>; bindings = <&uc 0x3D 0>; };  // eq = =
    // seq_m_eq_delta { sequence = <M E Q D E L T A>; bindings = <&uc 0x225C 0>; };  // eq.delta = ≜
    // seq_m_eq_dot { sequence = <M E Q D O T>; bindings = <&uc 0x2250 0>; };  // eq.dot = ≐
    // seq_m_eq_dots { sequence = <M E Q D O T S>; bindings = <&uc 0x2251 0>; };  // eq.dots = ≑
    // seq_m_eq_m { sequence = <M E Q M>; bindings = <&uc 0x225E 0>; };  // eq.m = ≞
    // seq_m_eq_o { sequence = <M E Q O>; bindings = <&uc 0x229C 0>; };  // eq.o = ⊜
    // seq_m_eq_star { sequence = <M E Q S T A R>; bindings = <&uc 0x225B 0>; };  // eq.star = ≛
    // seq_m_errorbar_circle_filled { sequence = <M E R R O R B A R C I R C L E F I L L E D>; bindings = <&uc 0x29F3 0>; };  // errorbar.circle.filled = ⧳
    // seq_m_errorbar_circle_stroked { sequence = <M E R R O R B A R C I R C L E S T R O K E D>; bindings = <&uc 0x29F2 0>; };  // errorbar.circle.stroked = ⧲
    // seq_m_errorbar_diamond_filled { sequence = <M E R R O R B A R D I A M O N D F I L L E D>; bindings = <&uc 0x29F1 0>; };  // errorbar.diamond.filled = ⧱
    // seq_m_errorbar_diamond_stroked { sequence = <M E R R O R B A R D I A M O N D S T R O K E D>; bindings = <&uc 0x29F0 0>; };  // errorbar.diamond.stroked = ⧰
    // seq_m_errorbar_square_filled { sequence = <M E R R O R B A R S Q U A R E F I L L E D>; bindings = <&uc 0x29EF 0>; };  // errorbar.square.filled = ⧯
    // seq_m_errorbar_square_stroked { sequence = <M E R R O R B A R S Q U A R E S T R O K E D>; bindings = <&uc 0x29EE 0>; };  // errorbar.square.stroked = ⧮
    // seq_m_excl { sequence = <M E X C L>; bindings = <&uc 0x21 0>; };  // excl = !
    // seq_m_excl_inv { sequence = <M E X C L I N V>; bindings = <&uc 0xA1 0>; };  // excl.inv = ¡
    // seq_m_feminine { sequence = <M F E M I N I N E>; bindings = <&uc 0xAA 0>; };  // feminine = ª
    // seq_m_fence_dotted { sequence = <M F E N C E D O T T E D>; bindings = <&uc 0x2999 0>; };  // fence.dotted = ⦙
    // seq_m_floor_l { sequence = <M F L O O R L>; bindings = <&uc 0x230A 0>; };  // floor.l = ⌊
    // seq_m_floor_r { sequence = <M F L O O R R>; bindings = <&uc 0x230B 0>; };  // floor.r = ⌋
    // seq_m_floral { sequence = <M F L O R A L>; bindings = <&uc 0x2766 0>; };  // floral = ❦
    // seq_m_floral_l { sequence = <M F L O R A L L>; bindings = <&uc 0x2619 0>; };  // floral.l = ☙
    // seq_m_floral_r { sequence = <M F L O R A L R>; bindings = <&uc 0x2767 0>; };  // floral.r = ❧
    // seq_m_frown { sequence = <M F R O W N>; bindings = <&uc 0x2322 0>; };  // frown = ⌢
    // seq_m_gender { sequence = <M G E N D E R>; bindings = <&uc 0x7B 0>; };  // gender = {
    // seq_m_gimel { sequence = <M G I M E L>; bindings = <&uc 0x5D2 0>; };  // gimel = ג
    // seq_m_gt { sequence = <M G T>; bindings = <&uc 0x3E 0>; };  // gt = >
    // seq_m_gt_closed_eq_not { sequence = <M G T C L O S E D E Q N O T>; bindings = <&uc 0x22ED 0>; };  // gt.closed.eq.not = ⋭
    // seq_m_gt_closed_not { sequence = <M G T C L O S E D N O T>; bindings = <&uc 0x22EB 0>; };  // gt.closed.not = ⋫
    // seq_m_gt_dot { sequence = <M G T D O T>; bindings = <&uc 0x22D7 0>; };  // gt.dot = ⋗
    // seq_m_gt_double { sequence = <M G T D O U B L E>; bindings = <&uc 0x226B 0>; };  // gt.double = ≫
    // seq_m_gt_double_nested { sequence = <M G T D O U B L E N E S T E D>; bindings = <&uc 0x2AA2 0>; };  // gt.double.nested = ⪢
    // seq_m_gt_eq_lt_slant { sequence = <M G T E Q L T S L A N T>; bindings = <&uc 0x22DB 0 &uc 0x5C 0 &uc 0x76 0 &uc 0x73 0 &uc 0x7B 0 &uc 0x31 0 &uc 0x7D 0>; };  // gt.eq.lt.slant = ⋛\vs{1}
    // seq_m_gt_tilde_slant { sequence = <M G T T I L D E S L A N T>; bindings = <&uc 0x2273 0 &uc 0x5C 0 &uc 0x76 0 &uc 0x73 0 &uc 0x7B 0 &uc 0x31 0 &uc 0x7D 0>; };  // gt.tilde.slant = ≳\vs{1}
    // seq_m_gt_triple_nested { sequence = <M G T T R I P L E N E S T E D>; bindings = <&uc 0x2AF8 0>; };  // gt.triple.nested = ⫸
    // seq_m_harpoon_bl_bar { sequence = <M H A R P O O N B L B A R>; bindings = <&uc 0x2961 0>; };  // harpoon.bl.bar = ⥡
    // seq_m_harpoon_bl_stop { sequence = <M H A R P O O N B L S T O P>; bindings = <&uc 0x2959 0>; };  // harpoon.bl.stop = ⥙
    // seq_m_harpoon_br_bar { sequence = <M H A R P O O N B R B A R>; bindings = <&uc 0x295D 0>; };  // harpoon.br.bar = ⥝
    // seq_m_harpoon_br_stop { sequence = <M H A R P O O N B R S T O P>; bindings = <&uc 0x2955 0>; };  // harpoon.br.stop = ⥕
    // seq_m_harpoon_lb_bar { sequence = <M H A R P O O N L B B A R>; bindings = <&uc 0x295E 0>; };  // harpoon.lb.bar = ⥞
    // seq_m_harpoon_lb_stop { sequence = <M H A R P O O N L B S T O P>; bindings = <&uc 0x2956 0>; };  // harpoon.lb.stop = ⥖
    // seq_m_harpoon_lt_bar { sequence = <M H A R P O O N L T B A R>; bindings = <&uc 0x295A 0>; };  // harpoon.lt.bar = ⥚
    // seq_m_harpoon_lt_stop { sequence = <M H A R P O O N L T S T O P>; bindings = <&uc 0x2952 0>; };  // harpoon.lt.stop = ⥒
    // seq_m_harpoon_rb_bar { sequence = <M H A R P O O N R B B A R>; bindings = <&uc 0x295F 0>; };  // harpoon.rb.bar = ⥟
    // seq_m_harpoon_rb_stop { sequence = <M H A R P O O N R B S T O P>; bindings = <&uc 0x2957 0>; };  // harpoon.rb.stop = ⥗
    // seq_m_harpoon_rt_bar { sequence = <M H A R P O O N R T B A R>; bindings = <&uc 0x295B 0>; };  // harpoon.rt.bar = ⥛
    // seq_m_harpoon_rt_stop { sequence = <M H A R P O O N R T S T O P>; bindings = <&uc 0x2953 0>; };  // harpoon.rt.stop = ⥓
    // seq_m_harpoon_tl_bar { sequence = <M H A R P O O N T L B A R>; bindings = <&uc 0x2960 0>; };  // harpoon.tl.bar = ⥠
    // seq_m_harpoon_tl_stop { sequence = <M H A R P O O N T L S T O P>; bindings = <&uc 0x2958 0>; };  // harpoon.tl.stop = ⥘
    // seq_m_harpoon_tr_bar { sequence = <M H A R P O O N T R B A R>; bindings = <&uc 0x295C 0>; };  // harpoon.tr.bar = ⥜
    // seq_m_harpoon_tr_stop { sequence = <M H A R P O O N T R S T O P>; bindings = <&uc 0x2954 0>; };  // harpoon.tr.stop = ⥔
    // seq_m_hash { sequence = <M H A S H>; bindings = <&uc 0x23 0 &uc 0xFE0E 0>; };  // hash = #
    // seq_m_hexa_filled { sequence = <M H E X A F I L L E D>; bindings = <&uc 0x2B22 0>; };  // hexa.filled = ⬢
    // seq_m_hexa_stroked { sequence = <M H E X A S T R O K E D>; bindings = <&uc 0x2B21 0>; };  // hexa.stroked = ⬡
    // seq_m_hyph { sequence = <M H Y P H>; bindings = <&uc 0x2010 0>; };  // hyph = ‐
    // seq_m_hyph_minus { sequence = <M H Y P H M I N U S>; bindings = <&uc 0x2D 0>; };  // hyph.minus = -
    // seq_m_hyph_nobreak { sequence = <M H Y P H N O B R E A K>; bindings = <&uc 0x2011 0>; };  // hyph.nobreak = ‑
    // seq_m_hyph_point { sequence = <M H Y P H P O I N T>; bindings = <&uc 0x2027 0>; };  // hyph.point = ‧
    // seq_m_hyph_soft { sequence = <M H Y P H S O F T>; bindings = <&uc 0xAD 0>; };  // hyph.soft = ­
    // seq_m_integral_arrow_hook { sequence = <M I N T E G R A L A R R O W H O O K>; bindings = <&uc 0x2A17 0>; };  // integral.arrow.hook = ⨗
    // seq_m_integral_ccw { sequence = <M I N T E G R A L C C W>; bindings = <&uc 0x2A11 0>; };  // integral.ccw = ⨑
    // seq_m_integral_cont_ccw { sequence = <M I N T E G R A L C O N T C C W>; bindings = <&uc 0x2233 0>; };  // integral.cont.ccw = ∳
    // seq_m_integral_cont_cw { sequence = <M I N T E G R A L C O N T C W>; bindings = <&uc 0x2232 0>; };  // integral.cont.cw = ∲
    // seq_m_integral_cw { sequence = <M I N T E G R A L C W>; bindings = <&uc 0x2231 0>; };  // integral.cw = ∱
    // seq_m_integral_dash_double { sequence = <M I N T E G R A L D A S H D O U B L E>; bindings = <&uc 0x2A0E 0>; };  // integral.dash.double = ⨎
    // seq_m_integral_inter { sequence = <M I N T E G R A L I N T E R>; bindings = <&uc 0x2A19 0>; };  // integral.inter = ⨙
    // seq_m_integral_quad { sequence = <M I N T E G R A L Q U A D>; bindings = <&uc 0x2A0C 0>; };  // integral.quad = ⨌
    // seq_m_integral_slash { sequence = <M I N T E G R A L S L A S H>; bindings = <&uc 0x2A0F 0>; };  // integral.slash = ⨏
    // seq_m_integral_square { sequence = <M I N T E G R A L S Q U A R E>; bindings = <&uc 0x2A16 0>; };  // integral.square = ⨖
    // seq_m_integral_surf { sequence = <M I N T E G R A L S U R F>; bindings = <&uc 0x222F 0>; };  // integral.surf = ∯
    // seq_m_integral_times { sequence = <M I N T E G R A L T I M E S>; bindings = <&uc 0x2A18 0>; };  // integral.times = ⨘
    // seq_m_integral_union { sequence = <M I N T E G R A L U N I O N>; bindings = <&uc 0x2A1A 0>; };  // integral.union = ⨚
    // seq_m_integral_vol { sequence = <M I N T E G R A L V O L>; bindings = <&uc 0x2230 0>; };  // integral.vol = ∰
    // seq_m_inter_and { sequence = <M I N T E R A N D>; bindings = <&uc 0x2A44 0>; };  // inter.and = ⩄
    // seq_m_inter_dot { sequence = <M I N T E R D O T>; bindings = <&uc 0x2A40 0>; };  // inter.dot = ⩀
    // seq_m_inter_double { sequence = <M I N T E R D O U B L E>; bindings = <&uc 0x22D2 0>; };  // inter.double = ⋒
    // seq_m_inter_serif { sequence = <M I N T E R S E R I F>; bindings = <&uc 0x2229 0 &uc 0x5C 0 &uc 0x76 0 &uc 0x73 0 &uc 0x7B 0 &uc 0x31 0 &uc 0x7D 0>; };  // inter.serif = ∩\vs{1}
    // seq_m_inter_sq_double { sequence = <M I N T E R S Q D O U B L E>; bindings = <&uc 0x2A4E 0>; };  // inter.sq.double = ⩎
    // seq_m_inter_sq_serif { sequence = <M I N T E R S Q S E R I F>; bindings = <&uc 0x2293 0 &uc 0x5C 0 &uc 0x76 0 &uc 0x73 0 &uc 0x7B 0 &uc 0x31 0 &uc 0x7D 0>; };  // inter.sq.serif = ⊓\vs{1}
    // seq_m_interleave { sequence = <M I N T E R L E A V E>; bindings = <&uc 0x2AF4 0>; };  // interleave = ⫴
    // seq_m_interleave_big { sequence = <M I N T E R L E A V E B I G>; bindings = <&uc 0x2AFC 0>; };  // interleave.big = ⫼
    // seq_m_interleave_struck { sequence = <M I N T E R L E A V E S T R U C K>; bindings = <&uc 0x2AF5 0>; };  // interleave.struck = ⫵
    // seq_m_king_black { sequence = <M K I N G B L A C K>; bindings = <&uc 0x265A 0>; };  // king.black = ♚
    // seq_m_king_white { sequence = <M K I N G W H I T E>; bindings = <&uc 0x2654 0>; };  // king.white = ♔
    // seq_m_knight_black { sequence = <M K N I G H T B L A C K>; bindings = <&uc 0x265E 0>; };  // knight.black = ♞
    // seq_m_knight_white { sequence = <M K N I G H T W H I T E>; bindings = <&uc 0x2658 0>; };  // knight.white = ♘
    // seq_m_lat_eq_slant { sequence = <M L A T E Q S L A N T>; bindings = <&uc 0x2AAD 0 &uc 0x5C 0 &uc 0x76 0 &uc 0x73 0 &uc 0x7B 0 &uc 0x31 0 &uc 0x7D 0>; };  // lat.eq.slant = ⪭\vs{1}
    // seq_m_lozenge_filled { sequence = <M L O Z E N G E F I L L E D>; bindings = <&uc 0x29EB 0>; };  // lozenge.filled = ⧫
    // seq_m_lozenge_filled_small { sequence = <M L O Z E N G E F I L L E D S M A L L>; bindings = <&uc 0x2B2A 0>; };  // lozenge.filled.small = ⬪
    // seq_m_lozenge_stroked { sequence = <M L O Z E N G E S T R O K E D>; bindings = <&uc 0x25CA 0>; };  // lozenge.stroked = ◊
    // seq_m_lozenge_stroked_medium { sequence = <M L O Z E N G E S T R O K E D M E D I U M>; bindings = <&uc 0x2B28 0>; };  // lozenge.stroked.medium = ⬨
    // seq_m_lozenge_stroked_small { sequence = <M L O Z E N G E S T R O K E D S M A L L>; bindings = <&uc 0x2B2B 0>; };  // lozenge.stroked.small = ⬫
    // seq_m_lt { sequence = <M L T>; bindings = <&uc 0x3C 0>; };  // lt = <
    // seq_m_lt_closed_eq { sequence = <M L T C L O S E D E Q>; bindings = <&uc 0x22B4 0>; };  // lt.closed.eq = ⊴
    // seq_m_lt_closed_eq_not { sequence = <M L T C L O S E D E Q N O T>; bindings = <&uc 0x22EC 0>; };  // lt.closed.eq.not = ⋬
    // seq_m_lt_closed_not { sequence = <M L T C L O S E D N O T>; bindings = <&uc 0x22EA 0>; };  // lt.closed.not = ⋪
    // seq_m_lt_dot { sequence = <M L T D O T>; bindings = <&uc 0x22D6 0>; };  // lt.dot = ⋖
    // seq_m_lt_double { sequence = <M L T D O U B L E>; bindings = <&uc 0x226A 0>; };  // lt.double = ≪
    // seq_m_lt_double_nested { sequence = <M L T D O U B L E N E S T E D>; bindings = <&uc 0x2AA1 0>; };  // lt.double.nested = ⪡
    // seq_m_lt_eq_gt_slant { sequence = <M L T E Q G T S L A N T>; bindings = <&uc 0x22DA 0 &uc 0x5C 0 &uc 0x76 0 &uc 0x73 0 &uc 0x7B 0 &uc 0x31 0 &uc 0x7D 0>; };  // lt.eq.gt.slant = ⋚\vs{1}
    // seq_m_lt_tilde_slant { sequence = <M L T T I L D E S L A N T>; bindings = <&uc 0x2272 0 &uc 0x5C 0 &uc 0x76 0 &uc 0x73 0 &uc 0x7B 0 &uc 0x31 0 &uc 0x7D 0>; };  // lt.tilde.slant = ≲\vs{1}
    // seq_m_lt_triple_nested { sequence = <M L T T R I P L E N E S T E D>; bindings = <&uc 0x2AF7 0>; };  // lt.triple.nested = ⫷
    // seq_m_male_stroke { sequence = <M M A L E S T R O K E>; bindings = <&uc 0x26A6 0>; };  // male.stroke = ⚦
    // seq_m_male_stroke_r { sequence = <M M A L E S T R O K E R>; bindings = <&uc 0x26A9 0>; };  // male.stroke.r = ⚩
    // seq_m_male_stroke_t { sequence = <M M A L E S T R O K E T>; bindings = <&uc 0x26A8 0>; };  // male.stroke.t = ⚨
    // seq_m_masculine { sequence = <M M A S C U L I N E>; bindings = <&uc 0xBA 0>; };  // masculine = º
    // seq_m_minus { sequence = <M M I N U S>; bindings = <&uc 0x2212 0>; };  // minus = −
    // seq_m_minus_dot { sequence = <M M I N U S D O T>; bindings = <&uc 0x2238 0>; };  // minus.dot = ∸
    // seq_m_minus_square { sequence = <M M I N U S S Q U A R E>; bindings = <&uc 0x229F 0>; };  // minus.square = ⊟
    // seq_m_mustache_l { sequence = <M M U S T A C H E L>; bindings = <&uc 0x23B0 0>; };  // mustache.l = ⎰
    // seq_m_mustache_r { sequence = <M M U S T A C H E R>; bindings = <&uc 0x23B1 0>; };  // mustache.r = ⎱
    // seq_m_neuter { sequence = <M N E U T E R>; bindings = <&uc 0x26B2 0>; };  // neuter = ⚲
    // seq_m_not_inv { sequence = <M N O T I N V>; bindings = <&uc 0x2319 0>; };  // not.inv = ⌙
    // seq_m_not_rev { sequence = <M N O T R E V>; bindings = <&uc 0x2310 0>; };  // not.rev = ⌐
    // seq_m_nothing_arrow_l { sequence = <M N O T H I N G A R R O W L>; bindings = <&uc 0x29B4 0>; };  // nothing.arrow.l = ⦴
    // seq_m_nothing_arrow_r { sequence = <M N O T H I N G A R R O W R>; bindings = <&uc 0x29B3 0>; };  // nothing.arrow.r = ⦳
    // seq_m_nothing_circle { sequence = <M N O T H I N G C I R C L E>; bindings = <&uc 0x29B2 0>; };  // nothing.circle = ⦲
    // seq_m_nothing_zero { sequence = <M N O T H I N G Z E R O>; bindings = <&uc 0x2205 0 &uc 0x5C 0 &uc 0x76 0 &uc 0x73 0 &uc 0x7B 0 &uc 0x31 0 &uc 0x7D 0>; };  // nothing.zero = ∅\vs{1}
    // seq_m_or_dot { sequence = <M O R D O T>; bindings = <&uc 0x27C7 0>; };  // or.dot = ⟇
    // seq_m_or_double { sequence = <M O R D O U B L E>; bindings = <&uc 0x2A54 0>; };  // or.double = ⩔
    // seq_m_ordinal { sequence = <M O R D I N A L>; bindings = <&uc 0x7B 0>; };  // ordinal = {
    // seq_m_parallel_o { sequence = <M P A R A L L E L O>; bindings = <&uc 0x29B7 0>; };  // parallel.o = ⦷
    // seq_m_parallel_slanted_eq { sequence = <M P A R A L L E L S L A N T E D E Q>; bindings = <&uc 0x29E3 0>; };  // parallel.slanted.eq = ⧣
    // seq_m_parallel_slanted_eq_tilde { sequence = <M P A R A L L E L S L A N T E D E Q T I L D E>; bindings = <&uc 0x29E4 0>; };  // parallel.slanted.eq.tilde = ⧤
    // seq_m_parallel_slanted_equiv { sequence = <M P A R A L L E L S L A N T E D E Q U I V>; bindings = <&uc 0x29E5 0>; };  // parallel.slanted.equiv = ⧥
    // seq_m_parallelogram_filled { sequence = <M P A R A L L E L O G R A M F I L L E D>; bindings = <&uc 0x25B0 0>; };  // parallelogram.filled = ▰
    // seq_m_parallelogram_stroked { sequence = <M P A R A L L E L O G R A M S T R O K E D>; bindings = <&uc 0x25B1 0>; };  // parallelogram.stroked = ▱
    // seq_m_paren_b { sequence = <M P A R E N B>; bindings = <&uc 0x23DD 0>; };  // paren.b = ⏝
    // seq_m_paren_l { sequence = <M P A R E N L>; bindings = <&uc 0x28 0>; };  // paren.l = (
    // seq_m_paren_l_closed { sequence = <M P A R E N L C L O S E D>; bindings = <&uc 0x2987 0>; };  // paren.l.closed = ⦇
    // seq_m_paren_l_flat { sequence = <M P A R E N L F L A T>; bindings = <&uc 0x27EE 0>; };  // paren.l.flat = ⟮
    // seq_m_paren_l_stroked { sequence = <M P A R E N L S T R O K E D>; bindings = <&uc 0x2985 0>; };  // paren.l.stroked = ⦅
    // seq_m_paren_r { sequence = <M P A R E N R>; bindings = <&uc 0x29 0>; };  // paren.r = )
    // seq_m_paren_r_closed { sequence = <M P A R E N R C L O S E D>; bindings = <&uc 0x2988 0>; };  // paren.r.closed = ⦈
    // seq_m_paren_r_stroked { sequence = <M P A R E N R S T R O K E D>; bindings = <&uc 0x2986 0>; };  // paren.r.stroked = ⦆
    // seq_m_paren_t { sequence = <M P A R E N T>; bindings = <&uc 0x23DC 0>; };  // paren.t = ⏜
    // seq_m_pawn_black { sequence = <M P A W N B L A C K>; bindings = <&uc 0x265F 0 &uc 0xFE0E 0>; };  // pawn.black = ♟
    // seq_m_pawn_white { sequence = <M P A W N W H I T E>; bindings = <&uc 0x2659 0>; };  // pawn.white = ♙
    // seq_m_penta_filled { sequence = <M P E N T A F I L L E D>; bindings = <&uc 0x2B1F 0>; };  // penta.filled = ⬟
    // seq_m_penta_stroked { sequence = <M P E N T A S T R O K E D>; bindings = <&uc 0x2B20 0>; };  // penta.stroked = ⬠
    // seq_m_percent { sequence = <M P E R C E N T>; bindings = <&uc 0x25 0>; };  // percent = %
    // seq_m_perp_o { sequence = <M P E R P O>; bindings = <&uc 0x29B9 0>; };  // perp.o = ⦹
    // seq_m_pilcrow_rev { sequence = <M P I L C R O W R E V>; bindings = <&uc 0x204B 0>; };  // pilcrow.rev = ⁋
    // seq_m_plus { sequence = <M P L U S>; bindings = <&uc 0x2B 0>; };  // plus = +
    // seq_m_plus_dot { sequence = <M P L U S D O T>; bindings = <&uc 0x2214 0>; };  // plus.dot = ∔
    // seq_m_plus_double { sequence = <M P L U S D O U B L E>; bindings = <&uc 0x29FA 0>; };  // plus.double = ⧺
    // seq_m_plus_hat { sequence = <M P L U S H A T>; bindings = <&uc 0x2A23 0>; };  // plus.hat = ⨣
    // seq_m_plus_o_arrow { sequence = <M P L U S O A R R O W>; bindings = <&uc 0x27F4 0>; };  // plus.o.arrow = ⟴
    // seq_m_plus_o_l { sequence = <M P L U S O L>; bindings = <&uc 0x2A2D 0>; };  // plus.o.l = ⨭
    // seq_m_plus_o_r { sequence = <M P L U S O R>; bindings = <&uc 0x2A2E 0>; };  // plus.o.r = ⨮
    // seq_m_power_off { sequence = <M P O W E R O F F>; bindings = <&uc 0x2B58 0>; };  // power.off = ⭘
    // seq_m_qed { sequence = <M Q E D>; bindings = <&uc 0x220E 0>; };  // qed = ∎
    // seq_m_queen_black { sequence = <M Q U E E N B L A C K>; bindings = <&uc 0x265B 0>; };  // queen.black = ♛
    // seq_m_queen_white { sequence = <M Q U E E N W H I T E>; bindings = <&uc 0x2655 0>; };  // queen.white = ♕
    // seq_m_quest { sequence = <M Q U E S T>; bindings = <&uc 0x3F 0>; };  // quest = ?
    // seq_m_rect_filled_h { sequence = <M R E C T F I L L E D H>; bindings = <&uc 0x25AC 0>; };  // rect.filled.h = ▬
    // seq_m_rect_filled_v { sequence = <M R E C T F I L L E D V>; bindings = <&uc 0x25AE 0>; };  // rect.filled.v = ▮
    // seq_m_rect_stroked_h { sequence = <M R E C T S T R O K E D H>; bindings = <&uc 0x25AD 0>; };  // rect.stroked.h = ▭
    // seq_m_rect_stroked_v { sequence = <M R E C T S T R O K E D V>; bindings = <&uc 0x25AF 0>; };  // rect.stroked.v = ▯
    // seq_m_refmark { sequence = <M R E F M A R K>; bindings = <&uc 0x203B 0>; };  // refmark = ※
    // seq_m_rook_black { sequence = <M R O O K B L A C K>; bindings = <&uc 0x265C 0>; };  // rook.black = ♜
    // seq_m_rook_white { sequence = <M R O O K W H I T E>; bindings = <&uc 0x2656 0>; };  // rook.white = ♖
    // seq_m_section { sequence = <M S E C T I O N>; bindings = <&uc 0xA7 0>; };  // section = §
    // seq_m_semi { sequence = <M S E M I>; bindings = <&uc 0x3B 0>; };  // semi = ;
    // seq_m_semi_inv { sequence = <M S E M I I N V>; bindings = <&uc 0x2E35 0>; };  // semi.inv = ⸵
    // seq_m_semi_rev { sequence = <M S E M I R E V>; bindings = <&uc 0x204F 0>; };  // semi.rev = ⁏
    // seq_m_shell_b { sequence = <M S H E L L B>; bindings = <&uc 0x23E1 0>; };  // shell.b = ⏡
    // seq_m_shell_l { sequence = <M S H E L L L>; bindings = <&uc 0x2772 0>; };  // shell.l = ❲
    // seq_m_shell_l_filled { sequence = <M S H E L L L F I L L E D>; bindings = <&uc 0x2997 0>; };  // shell.l.filled = ⦗
    // seq_m_shell_l_stroked { sequence = <M S H E L L L S T R O K E D>; bindings = <&uc 0x27EC 0>; };  // shell.l.stroked = ⟬
    // seq_m_shell_r { sequence = <M S H E L L R>; bindings = <&uc 0x2773 0>; };  // shell.r = ❳
    // seq_m_shell_r_filled { sequence = <M S H E L L R F I L L E D>; bindings = <&uc 0x2998 0>; };  // shell.r.filled = ⦘
    // seq_m_shell_r_stroked { sequence = <M S H E L L R S T R O K E D>; bindings = <&uc 0x27ED 0>; };  // shell.r.stroked = ⟭
    // seq_m_shell_t { sequence = <M S H E L L T>; bindings = <&uc 0x23E0 0>; };  // shell.t = ⏠
    // seq_m_slash { sequence = <M S L A S H>; bindings = <&uc 0x2F 0>; };  // slash = /
    // seq_m_slash_double { sequence = <M S L A S H D O U B L E>; bindings = <&uc 0x2AFD 0>; };  // slash.double = ⫽
    // seq_m_slash_o { sequence = <M S L A S H O>; bindings = <&uc 0x2298 0>; };  // slash.o = ⊘
    // seq_m_slash_triple { sequence = <M S L A S H T R I P L E>; bindings = <&uc 0x2AFB 0>; };  // slash.triple = ⫻
    // seq_m_smash { sequence = <M S M A S H>; bindings = <&uc 0x2A33 0>; };  // smash = ⨳
    // seq_m_smile { sequence = <M S M I L E>; bindings = <&uc 0x2323 0>; };  // smile = ⌣
    // seq_m_smt_eq { sequence = <M S M T E Q>; bindings = <&uc 0x2AAC 0>; };  // smt.eq = ⪬
    // seq_m_smt_eq_slant { sequence = <M S M T E Q S L A N T>; bindings = <&uc 0x2AAC 0 &uc 0x5C 0 &uc 0x76 0 &uc 0x73 0 &uc 0x7B 0 &uc 0x31 0 &uc 0x7D 0>; };  // smt.eq.slant = ⪬\vs{1}
    // seq_m_square_filled { sequence = <M S Q U A R E F I L L E D>; bindings = <&uc 0x25A0 0>; };  // square.filled = ■
    // seq_m_square_filled_big { sequence = <M S Q U A R E F I L L E D B I G>; bindings = <&uc 0x2B1B 0 &uc 0xFE0E 0>; };  // square.filled.big = ⬛
    // seq_m_square_filled_medium { sequence = <M S Q U A R E F I L L E D M E D I U M>; bindings = <&uc 0x25FC 0 &uc 0xFE0E 0>; };  // square.filled.medium = ◼
    // seq_m_square_filled_small { sequence = <M S Q U A R E F I L L E D S M A L L>; bindings = <&uc 0x25FE 0 &uc 0xFE0E 0>; };  // square.filled.small = ◾
    // seq_m_square_filled_tiny { sequence = <M S Q U A R E F I L L E D T I N Y>; bindings = <&uc 0x25AA 0 &uc 0xFE0E 0>; };  // square.filled.tiny = ▪
    // seq_m_square_stroked { sequence = <M S Q U A R E S T R O K E D>; bindings = <&uc 0x25A1 0>; };  // square.stroked = □
    // seq_m_square_stroked_big { sequence = <M S Q U A R E S T R O K E D B I G>; bindings = <&uc 0x2B1C 0 &uc 0xFE0E 0>; };  // square.stroked.big = ⬜
    // seq_m_square_stroked_dotted { sequence = <M S Q U A R E S T R O K E D D O T T E D>; bindings = <&uc 0x2B1A 0>; };  // square.stroked.dotted = ⬚
    // seq_m_square_stroked_medium { sequence = <M S Q U A R E S T R O K E D M E D I U M>; bindings = <&uc 0x25FB 0 &uc 0xFE0E 0>; };  // square.stroked.medium = ◻
    // seq_m_square_stroked_rounded { sequence = <M S Q U A R E S T R O K E D R O U N D E D>; bindings = <&uc 0x25A2 0>; };  // square.stroked.rounded = ▢
    // seq_m_square_stroked_small { sequence = <M S Q U A R E S T R O K E D S M A L L>; bindings = <&uc 0x25FD 0 &uc 0xFE0E 0>; };  // square.stroked.small = ◽
    // seq_m_square_stroked_tiny { sequence = <M S Q U A R E S T R O K E D T I N Y>; bindings = <&uc 0x25AB 0 &uc 0xFE0E 0>; };  // square.stroked.tiny = ▫
    // seq_m_star_filled { sequence = <M S T A R F I L L E D>; bindings = <&uc 0x2605 0>; };  // star.filled = ★
    // seq_m_star_op { sequence = <M S T A R O P>; bindings = <&uc 0x22C6 0>; };  // star.op = ⋆
    // seq_m_star_stroked { sequence = <M S T A R S T R O K E D>; bindings = <&uc 0x2606 0>; };  // star.stroked = ☆
    // seq_m_subset_closed { sequence = <M S U B S E T C L O S E D>; bindings = <&uc 0x2ACF 0>; };  // subset.closed = ⫏
    // seq_m_subset_closed_eq { sequence = <M S U B S E T C L O S E D E Q>; bindings = <&uc 0x2AD1 0>; };  // subset.closed.eq = ⫑
    // seq_m_subset_dot { sequence = <M S U B S E T D O T>; bindings = <&uc 0x2ABD 0>; };  // subset.dot = ⪽
    // seq_m_subset_double { sequence = <M S U B S E T D O U B L E>; bindings = <&uc 0x22D0 0>; };  // subset.double = ⋐
    // seq_m_subset_plus { sequence = <M S U B S E T P L U S>; bindings = <&uc 0x2ABF 0>; };  // subset.plus = ⪿
    // seq_m_subset_times { sequence = <M S U B S E T T I M E S>; bindings = <&uc 0x2AC1 0>; };  // subset.times = ⫁
    // seq_m_suit_club_filled { sequence = <M S U I T C L U B F I L L E D>; bindings = <&uc 0x2663 0 &uc 0xFE0E 0>; };  // suit.club.filled = ♣
    // seq_m_suit_club_stroked { sequence = <M S U I T C L U B S T R O K E D>; bindings = <&uc 0x2667 0>; };  // suit.club.stroked = ♧
    // seq_m_suit_diamond_filled { sequence = <M S U I T D I A M O N D F I L L E D>; bindings = <&uc 0x2666 0 &uc 0xFE0E 0>; };  // suit.diamond.filled = ♦
    // seq_m_suit_diamond_stroked { sequence = <M S U I T D I A M O N D S T R O K E D>; bindings = <&uc 0x2662 0>; };  // suit.diamond.stroked = ♢
    // seq_m_suit_heart_filled { sequence = <M S U I T H E A R T F I L L E D>; bindings = <&uc 0x2665 0 &uc 0xFE0E 0>; };  // suit.heart.filled = ♥
    // seq_m_suit_heart_stroked { sequence = <M S U I T H E A R T S T R O K E D>; bindings = <&uc 0x2661 0>; };  // suit.heart.stroked = ♡
    // seq_m_suit_spade_filled { sequence = <M S U I T S P A D E F I L L E D>; bindings = <&uc 0x2660 0 &uc 0xFE0E 0>; };  // suit.spade.filled = ♠
    // seq_m_suit_spade_stroked { sequence = <M S U I T S P A D E S T R O K E D>; bindings = <&uc 0x2664 0>; };  // suit.spade.stroked = ♤
    // seq_m_supset_closed { sequence = <M S U P S E T C L O S E D>; bindings = <&uc 0x2AD0 0>; };  // supset.closed = ⫐
    // seq_m_supset_closed_eq { sequence = <M S U P S E T C L O S E D E Q>; bindings = <&uc 0x2AD2 0>; };  // supset.closed.eq = ⫒
    // seq_m_supset_dot { sequence = <M S U P S E T D O T>; bindings = <&uc 0x2ABE 0>; };  // supset.dot = ⪾
    // seq_m_supset_double { sequence = <M S U P S E T D O U B L E>; bindings = <&uc 0x22D1 0>; };  // supset.double = ⋑
    // seq_m_supset_eq_dot { sequence = <M S U P S E T E Q D O T>; bindings = <&uc 0x2AC4 0>; };  // supset.eq.dot = ⫄
    // seq_m_supset_plus { sequence = <M S U P S E T P L U S>; bindings = <&uc 0x2AC0 0>; };  // supset.plus = ⫀
    // seq_m_supset_sq_neq { sequence = <M S U P S E T S Q N E Q>; bindings = <&uc 0x22E5 0>; };  // supset.sq.neq = ⋥
    // seq_m_supset_times { sequence = <M S U P S E T T I M E S>; bindings = <&uc 0x2AC2 0>; };  // supset.times = ⫂
    // seq_m_tack_b_double_short { sequence = <M T A C K B D O U B L E S H O R T>; bindings = <&uc 0x2AE7 0>; };  // tack.b.double.short = ⫧
    // seq_m_tack_ll_double { sequence = <M T A C K L L D O U B L E>; bindings = <&uc 0x2AE5 0>; };  // tack.ll.double = ⫥
    // seq_m_tack_r_double_not { sequence = <M T A C K R D O U B L E N O T>; bindings = <&uc 0x22AE 0>; };  // tack.r.double.not = ⊮
    // seq_m_tack_rr_double { sequence = <M T A C K R R D O U B L E>; bindings = <&uc 0x22AB 0>; };  // tack.rr.double = ⊫
    // seq_m_tack_rr_double_not { sequence = <M T A C K R R D O U B L E N O T>; bindings = <&uc 0x22AF 0>; };  // tack.rr.double.not = ⊯
    // seq_m_tack_t_double_short { sequence = <M T A C K T D O U B L E S H O R T>; bindings = <&uc 0x2AE8 0>; };  // tack.t.double.short = ⫨
    // seq_m_tilde_basic { sequence = <M T I L D E B A S I C>; bindings = <&uc 0x7E 0>; };  // tilde.basic = ~
    // seq_m_tilde_dot { sequence = <M T I L D E D O T>; bindings = <&uc 0x2A6A 0>; };  // tilde.dot = ⩪
    // seq_m_tilde_eq { sequence = <M T I L D E E Q>; bindings = <&uc 0x2243 0>; };  // tilde.eq = ≃
    // seq_m_tilde_eq_not { sequence = <M T I L D E E Q N O T>; bindings = <&uc 0x2244 0>; };  // tilde.eq.not = ≄
    // seq_m_tilde_eq_rev { sequence = <M T I L D E E Q R E V>; bindings = <&uc 0x22CD 0>; };  // tilde.eq.rev = ⋍
    // seq_m_tilde_equiv { sequence = <M T I L D E E Q U I V>; bindings = <&uc 0x2245 0>; };  // tilde.equiv = ≅
    // seq_m_tilde_equiv_not { sequence = <M T I L D E E Q U I V N O T>; bindings = <&uc 0x2247 0>; };  // tilde.equiv.not = ≇
    // seq_m_tilde_gt { sequence = <M T I L D E G T>; bindings = <&uc 0x2A9E 0>; };  // tilde.gt = ⪞
    // seq_m_tilde_gt_slant { sequence = <M T I L D E G T S L A N T>; bindings = <&uc 0x2A9E 0 &uc 0x5C 0 &uc 0x76 0 &uc 0x73 0 &uc 0x7B 0 &uc 0x31 0 &uc 0x7D 0>; };  // tilde.gt.slant = ⪞\vs{1}
    // seq_m_tilde_lt { sequence = <M T I L D E L T>; bindings = <&uc 0x2A9D 0>; };  // tilde.lt = ⪝
    // seq_m_tilde_lt_slant { sequence = <M T I L D E L T S L A N T>; bindings = <&uc 0x2A9D 0 &uc 0x5C 0 &uc 0x76 0 &uc 0x73 0 &uc 0x7B 0 &uc 0x31 0 &uc 0x7D 0>; };  // tilde.lt.slant = ⪝\vs{1}
    // seq_m_tilde_nequiv { sequence = <M T I L D E N E Q U I V>; bindings = <&uc 0x2246 0>; };  // tilde.nequiv = ≆
    // seq_m_tilde_not { sequence = <M T I L D E N O T>; bindings = <&uc 0x2241 0>; };  // tilde.not = ≁
    // seq_m_tilde_op { sequence = <M T I L D E O P>; bindings = <&uc 0x223C 0>; };  // tilde.op = ∼
    // seq_m_tilde_rev { sequence = <M T I L D E R E V>; bindings = <&uc 0x223D 0>; };  // tilde.rev = ∽
    // seq_m_tilde_rev_equiv { sequence = <M T I L D E R E V E Q U I V>; bindings = <&uc 0x224C 0>; };  // tilde.rev.equiv = ≌
    // seq_m_tilde_triple { sequence = <M T I L D E T R I P L E>; bindings = <&uc 0x224B 0>; };  // tilde.triple = ≋
    // seq_m_times_o_hat { sequence = <M T I M E S O H A T>; bindings = <&uc 0x2A36 0>; };  // times.o.hat = ⨶
    // seq_m_times_o_l { sequence = <M T I M E S O L>; bindings = <&uc 0x2A34 0>; };  // times.o.l = ⨴
    // seq_m_times_o_r { sequence = <M T I M E S O R>; bindings = <&uc 0x2A35 0>; };  // times.o.r = ⨵
    // seq_m_times_square { sequence = <M T I M E S S Q U A R E>; bindings = <&uc 0x22A0 0>; };  // times.square = ⊠
    // seq_m_triangle_filled_b { sequence = <M T R I A N G L E F I L L E D B>; bindings = <&uc 0x25BC 0>; };  // triangle.filled.b = ▼
    // seq_m_triangle_filled_bl { sequence = <M T R I A N G L E F I L L E D B L>; bindings = <&uc 0x25E3 0>; };  // triangle.filled.bl = ◣
    // seq_m_triangle_filled_br { sequence = <M T R I A N G L E F I L L E D B R>; bindings = <&uc 0x25E2 0>; };  // triangle.filled.br = ◢
    // seq_m_triangle_filled_l { sequence = <M T R I A N G L E F I L L E D L>; bindings = <&uc 0x25C0 0 &uc 0xFE0E 0>; };  // triangle.filled.l = ◀
    // seq_m_triangle_filled_r { sequence = <M T R I A N G L E F I L L E D R>; bindings = <&uc 0x25B6 0 &uc 0xFE0E 0>; };  // triangle.filled.r = ▶
    // seq_m_triangle_filled_t { sequence = <M T R I A N G L E F I L L E D T>; bindings = <&uc 0x25B2 0>; };  // triangle.filled.t = ▲
    // seq_m_triangle_filled_tl { sequence = <M T R I A N G L E F I L L E D T L>; bindings = <&uc 0x25E4 0>; };  // triangle.filled.tl = ◤
    // seq_m_triangle_filled_tr { sequence = <M T R I A N G L E F I L L E D T R>; bindings = <&uc 0x25E5 0>; };  // triangle.filled.tr = ◥
    // seq_m_triangle_stroked_b { sequence = <M T R I A N G L E S T R O K E D B>; bindings = <&uc 0x25BD 0>; };  // triangle.stroked.b = ▽
    // seq_m_triangle_stroked_bl { sequence = <M T R I A N G L E S T R O K E D B L>; bindings = <&uc 0x25FA 0>; };  // triangle.stroked.bl = ◺
    // seq_m_triangle_stroked_br { sequence = <M T R I A N G L E S T R O K E D B R>; bindings = <&uc 0x25FF 0>; };  // triangle.stroked.br = ◿
    // seq_m_triangle_stroked_dot { sequence = <M T R I A N G L E S T R O K E D D O T>; bindings = <&uc 0x25EC 0>; };  // triangle.stroked.dot = ◬
    // seq_m_triangle_stroked_l { sequence = <M T R I A N G L E S T R O K E D L>; bindings = <&uc 0x25C1 0>; };  // triangle.stroked.l = ◁
    // seq_m_triangle_stroked_nested { sequence = <M T R I A N G L E S T R O K E D N E S T E D>; bindings = <&uc 0x27C1 0>; };  // triangle.stroked.nested = ⟁
    // seq_m_triangle_stroked_r { sequence = <M T R I A N G L E S T R O K E D R>; bindings = <&uc 0x25B7 0>; };  // triangle.stroked.r = ▷
    // seq_m_triangle_stroked_rounded { sequence = <M T R I A N G L E S T R O K E D R O U N D E D>; bindings = <&uc 0x1F6C6 0>; };  // triangle.stroked.rounded = 🛆
    // seq_m_triangle_stroked_t { sequence = <M T R I A N G L E S T R O K E D T>; bindings = <&uc 0x25B3 0>; };  // triangle.stroked.t = △
    // seq_m_triangle_stroked_tl { sequence = <M T R I A N G L E S T R O K E D T L>; bindings = <&uc 0x25F8 0>; };  // triangle.stroked.tl = ◸
    // seq_m_triangle_stroked_tr { sequence = <M T R I A N G L E S T R O K E D T R>; bindings = <&uc 0x25F9 0>; };  // triangle.stroked.tr = ◹
    // seq_m_underscore { sequence = <M U N D E R S C O R E>; bindings = <&uc 0x5F 0>; };  // underscore = _
    // seq_m_union_arrow { sequence = <M U N I O N A R R O W>; bindings = <&uc 0x228C 0>; };  // union.arrow = ⊌
    // seq_m_union_dot { sequence = <M U N I O N D O T>; bindings = <&uc 0x228D 0>; };  // union.dot = ⊍
    // seq_m_union_dot_big { sequence = <M U N I O N D O T B I G>; bindings = <&uc 0x2A03 0>; };  // union.dot.big = ⨃
    // seq_m_union_double { sequence = <M U N I O N D O U B L E>; bindings = <&uc 0x22D3 0>; };  // union.double = ⋓
    // seq_m_union_minus { sequence = <M U N I O N M I N U S>; bindings = <&uc 0x2A41 0>; };  // union.minus = ⩁
    // seq_m_union_or { sequence = <M U N I O N O R>; bindings = <&uc 0x2A45 0>; };  // union.or = ⩅
    // seq_m_union_plus { sequence = <M U N I O N P L U S>; bindings = <&uc 0x228E 0>; };  // union.plus = ⊎
    // seq_m_union_plus_big { sequence = <M U N I O N P L U S B I G>; bindings = <&uc 0x2A04 0>; };  // union.plus.big = ⨄
    // seq_m_union_serif { sequence = <M U N I O N S E R I F>; bindings = <&uc 0x222A 0 &uc 0x5C 0 &uc 0x76 0 &uc 0x73 0 &uc 0x7B 0 &uc 0x31 0 &uc 0x7D 0>; };  // union.serif = ∪\vs{1}
    // seq_m_union_sq_double { sequence = <M U N I O N S Q D O U B L E>; bindings = <&uc 0x2A4F 0>; };  // union.sq.double = ⩏
    // seq_m_union_sq_serif { sequence = <M U N I O N S Q S E R I F>; bindings = <&uc 0x2294 0 &uc 0x5C 0 &uc 0x76 0 &uc 0x73 0 &uc 0x7B 0 &uc 0x31 0 &uc 0x7D 0>; };  // union.sq.serif = ⊔\vs{1}
    // seq_m_wreath { sequence = <M W R E A T H>; bindings = <&uc 0x2240 0>; };  // wreath = ≀
    // seq_m_zero { sequence = <M Z E R O>; bindings = <&uc 0x30 0 &uc 0xFE0E 0>; };  // zero = 0
    // seq_m_zero_slashed { sequence = <M Z E R O S L A S H E D>; bindings = <&uc 0x30 0 &uc 0x5C 0 &uc 0x76 0 &uc 0x73 0 &uc 0x7B 0 &uc 0x31 0 &uc 0x7D 0>; };  // zero.slashed = 0\vs{1}
};
