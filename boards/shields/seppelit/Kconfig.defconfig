## boards/shields/seppelit/Kconfig.defconfig
```kconfig
if SHIELD_SEPPELIT_LEFT

config ZMK_KEYBOARD_NAME
    default "Seppelit"

config ZMK_SPLIT_ROLE_CENTRAL
    default y

endif

if SHIELD_SEPPELIT_LEFT || SHIELD_SEPPELIT_RIGHT

config ZMK_SPLIT
    default y

endif
```

## boards/shields/seppelit/Kconfig.shield
```kconfig
# Copyright (c) 2020 Pete Johanson
# SPDX-License-Identifier: MIT

config SHIELD_SEPPELIT_LEFT
    def_bool $(shields_list_contains,seppelit_left)

config SHIELD_SEPPELIT_RIGHT
    def_bool $(shields_list_contains,seppelit_right)
```

## boards/shields/tempest/Kconfig.defconfig
```kconfig
if SHIELD_TEMPEST_LEFT

config ZMK_KEYBOARD_NAME
    default "HeiKey"

config ZMK_SPLIT_ROLE_CENTRAL
    default y

endif

if SHIELD_TEMPEST_LEFT || SHIELD_TEMPEST_RIGHT

config ZMK_SPLIT
    default y

endif
```

## config/west.yml
```yaml
---
manifest:
  defaults:
    remote: zmkfirmware
    revision: main
    # revision: v0.1
  remotes:
    - name: zmkfirmware
      url-base: https://github.com/zmkfirmware
    - name: urob
      url-base: https://github.com/urob
    - name: joelspadin
      url-base: https://github.com/joelspadin
    - name: dddelispt42
      url-base: https://github.com/dddelispt42
  projects:
    - name: zmk
      remote: zmkfirmware
      # remote: urob
      # remote: dddelispt42
      # revision: v0.1+mouse
      import: app/west.yml
    - name: zmk-helpers
      remote: urob
    - name: zmk-locales
      remote: joelspadin
    - name: zmk-leader-key
      remote: urob
      # revision: v0.1+locality
    - name: zmk-auto-layer
      remote: urob
  self:
    path: config
```
